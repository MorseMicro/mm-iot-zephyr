## CMakeLists.txt
```
# Copyright 2026 Morse Micro
# SPDX-License-Identifier: Apache-2.0

cmake_minimum_required(VERSION 3.20.0)

find_package(Zephyr REQUIRED HINTS $ENV{ZEPHYR_BASE})
project(halow_ap_mode)

file(GLOB app_sources src/*.c)
target_sources(app PRIVATE ${app_sources})
```

## Kconfig
```
# Copyright 2026 Morse Micro
# SPDX-License-Identifier: Apache-2.0

mainmenu "Wi-Fi HaLow ap_mode application"

config AP_SSID
	string "SSID to advertise for the open AP"
	default "MorseMicroAP"

config AP_STATIC_IP
	string "Static IPv4 address for the AP interface"
	default "192.168.4.1"

config AP_STATIC_NETMASK
	string "Netmask for the AP interface"
	default "255.255.255.0"

config UDP_ECHO_PORT
	int "UDP port for the echo server"
	default 4242

config AP_CHANNEL
	int "S1G primary channel number for the AP"
	default 39

choice AP_BANDWIDTH
	bool "AP operating channel bandwidth in MHz"
	default AP_BANDWIDTH_1MHZ

	config AP_BANDWIDTH_1MHZ
		bool "1"

	config AP_BANDWIDTH_2MHZ
		bool "2"

	config AP_BANDWIDTH_4MHZ
		bool "4"

	config AP_BANDWIDTH_8MHZ
		bool "8"

endchoice

source "Kconfig.zephyr"
```

## sample.yaml
```
# Copyright 2026 Morse Micro
# SPDX-License-Identifier: Apache-2.0

tests:
  halow_ap_mode.build:
    platform_allow:
      - mm6108_ekh05
      - mm8108_ekh05
    build_only: true
    build_on_all: true
    tags:
      - build
  halow_ap_mode.build.shield:
    platform_allow:
      - nucleo_u575zi_q
    build_only: true
    build_on_all: true
    extra_args: SHIELD=morsemicro_mmech08
    tags:
      - shield
      - build
```

## prj.conf
```kconfig
# Copyright 2026 Morse Micro
# SPDX-License-Identifier: Apache-2.0

CONFIG_NETWORKING=y

CONFIG_NET_IPV4=y
CONFIG_NET_IPV6=n
CONFIG_NET_UDP=y
CONFIG_NET_SOCKETS=y
CONFIG_NET_SOCKETS_POLL_MAX=2

CONFIG_INIT_STACKS=y
CONFIG_MAIN_STACK_SIZE=4096
CONFIG_HEAP_MEM_POOL_SIZE=16384

CONFIG_WIFI=y
CONFIG_WIFI_MORSEMICRO_AP_MODE=y

CONFIG_LOG=y
CONFIG_NET_LOG=y
CONFIG_LOG_DEFAULT_LEVEL=3
CONFIG_WIFI_LOG_LEVEL_ERR=y
CONFIG_WIFI_NM=y

CONFIG_POSIX_API=y
```

## src/main.c
```c
/*
 * Copyright 2026 Morse Micro
 *
 * SPDX-License-Identifier: Apache-2.0
 */

#include <errno.h>
#include <zephyr/kernel.h>
#include <zephyr/logging/log.h>
#include <zephyr/net/net_if.h>

#include "ap.h"
#include "config.h"
#include "udp_echo.h"

LOG_MODULE_REGISTER(ap_mode_main, LOG_LEVEL_INF);

BUILD_ASSERT(strcmp(CONFIG_WIFI_MORSEMICRO_REGION, "00") != 0,
	     "Non interactive samples need CONFIG_WIFI_MORSEMICRO_REGION set to function");

int main(void)
{
	struct net_if *ap_iface = net_if_get_wifi_sap();
	int rc;

	if (!ap_iface) {
		LOG_ERR("No AP interface found - is CONFIG_WIFI_MORSEMICRO_AP_MODE enabled?");
		return -ENODEV;
	}

	rc = ap_start(ap_iface);
	if (rc) {
		return rc;
	}

	udp_echo_run(UDP_ECHO_PORT);

	return 0;
}
```

## src/ap.c
```c
/*
 * Copyright 2026 Morse Micro
 *
 * SPDX-License-Identifier: Apache-2.0
 */

#include <string.h>
#include <errno.h>
#include <zephyr/kernel.h>
#include <zephyr/logging/log.h>
#include <zephyr/net/net_if.h>
#include <zephyr/net/net_ip.h>
#include <zephyr/net/net_mgmt.h>
#include <zephyr/net/wifi_mgmt.h>

#include "ap.h"
#include "config.h"
#ifndef CONFIG_WIFI_MORSEMICRO_PATCHED
#include "morsemicro_mgmt.h"
#endif /* CONFIG_WIFI_MORSEMICRO_PATCHED */

LOG_MODULE_REGISTER(ap_mode_ap, LOG_LEVEL_INF);

static int set_static_ip(struct net_if *iface)
{
	struct in_addr addr;
	struct in_addr netmask;

	if (net_addr_pton(AF_INET, AP_STATIC_IP, &addr) < 0) {
		LOG_ERR("Invalid static IP %s", AP_STATIC_IP);
		return -EINVAL;
	}

	if (net_addr_pton(AF_INET, AP_STATIC_NETMASK, &netmask) < 0) {
		LOG_ERR("Invalid netmask %s", AP_STATIC_NETMASK);
		return -EINVAL;
	}

	if (!net_if_ipv4_addr_add(iface, &addr, NET_ADDR_MANUAL, 0)) {
		LOG_ERR("Failed to add static IPv4 address");
		return -EIO;
	}

	net_if_ipv4_set_netmask_by_addr(iface, &addr, &netmask);

	LOG_INF("AP static IPv4 address: %s/%s", AP_STATIC_IP, AP_STATIC_NETMASK);
	return 0;
}

#ifndef CONFIG_WIFI_MORSEMICRO_PATCHED
static int set_s1g_bandwidth(struct net_if *iface)
{
	uint8_t bw_mhz = AP_BANDWIDTH_MHZ;

	return net_mgmt(NET_REQUEST_MORSEMICRO_S1G_BANDWIDTH, iface, &bw_mhz, sizeof(bw_mhz));
}
#endif /* CONFIG_WIFI_MORSEMICRO_PATCHED */

int ap_start(struct net_if *iface)
{
	struct wifi_connect_req_params params = {0};

	int rc = set_static_ip(iface);
	if (rc) {
		return rc;
	}

#ifndef CONFIG_WIFI_MORSEMICRO_PATCHED
	rc = set_s1g_bandwidth(iface);
	if (rc) {
		LOG_ERR("S1G bandwidth request failed: %d", rc);
		return rc;
	}
#else
	switch (AP_BANDWIDTH_MHZ) {
	case 1:
		params.bandwidth = WIFI_FREQ_BANDWIDTH_1MHZ;
		break;
	case 2:
		params.bandwidth = WIFI_FREQ_BANDWIDTH_2MHZ;
		break;
	case 4:
		params.bandwidth = WIFI_FREQ_BANDWIDTH_4MHZ;
		break;
	case 8:
		params.bandwidth = WIFI_FREQ_BANDWIDTH_8MHZ;
		break;
	}
#endif /* CONFIG_WIFI_MORSEMICRO_PATCHED */

	params.ssid = AP_SSID;
	params.channel = AP_CHANNEL;
	params.ssid_length = strlen(AP_SSID);
	params.security = WIFI_SECURITY_TYPE_NONE;
	params.mfp = WIFI_MFP_DISABLE;

	LOG_INF("Starting open AP: %s", AP_SSID);
	rc = net_mgmt(NET_REQUEST_WIFI_AP_ENABLE, iface, &params, sizeof(params));
	if (rc) {
		LOG_ERR("AP enable request failed: %d", rc);
		return rc;
	}

	LOG_INF("AP started");
	return 0;
}
```

## src/ap.h
```c
/*
 * Copyright 2026 Morse Micro
 *
 * SPDX-License-Identifier: Apache-2.0
 */
#pragma once

#include <zephyr/net/net_if.h>

/**
 * @brief Assign a static IPv4 address and bring up an open AP on the interface.
 *
 * @param[in] iface: AP net_if, as returned by get_ap_iface().
 *
 * @return 0 on success, negative errno otherwise.
 */
int ap_start(struct net_if *iface);
```

## src/config.h
```c
/*
 * Copyright 2026 Morse Micro
 *
 * SPDX-License-Identifier: Apache-2.0
 */
#pragma once

#define AP_SSID CONFIG_AP_SSID

#define AP_STATIC_IP      CONFIG_AP_STATIC_IP
#define AP_STATIC_NETMASK CONFIG_AP_STATIC_NETMASK

#define UDP_ECHO_PORT CONFIG_UDP_ECHO_PORT
```

## src/udp_echo.c
```c
/*
 * Copyright 2026 Morse Micro
 *
 * SPDX-License-Identifier: Apache-2.0
 */

#include <errno.h>
#include <zephyr/kernel.h>
#include <zephyr/logging/log.h>
#include <zephyr/posix/arpa/inet.h>
#include <zephyr/posix/sys/socket.h>
#include <zephyr/posix/unistd.h>

#include "udp_echo.h"

LOG_MODULE_REGISTER(ap_mode_echo, LOG_LEVEL_INF);

void udp_echo_run(uint16_t port)
{
	int sock;
	struct sockaddr_in addr = {0};
	uint8_t buf[256];

	sock = socket(AF_INET, SOCK_DGRAM, IPPROTO_UDP);
	if (sock < 0) {
		LOG_ERR("Failed to create socket (%d)", errno);
		return;
	}

	addr.sin_family = AF_INET;
	addr.sin_port = htons(port);
	addr.sin_addr.s_addr = htonl(INADDR_ANY);

	if (bind(sock, (struct sockaddr *)&addr, sizeof(addr)) < 0) {
		LOG_ERR("Failed to bind socket (%d)", errno);
		close(sock);
		return;
	}

	LOG_INF("UDP echo server listening on port %u", port);

	while (1) {
		struct sockaddr_in src;
		socklen_t src_len = sizeof(src);
		int len = recvfrom(sock, buf, sizeof(buf), 0, (struct sockaddr *)&src, &src_len);

		if (len < 0) {
			LOG_ERR("recvfrom failed (%d)", errno);
			continue;
		}

		if (sendto(sock, buf, len, 0, (struct sockaddr *)&src, src_len) < 0) {
			LOG_ERR("sendto failed (%d)", errno);
		}
	}
}
```

## src/udp_echo.h
```c
/*
 * Copyright 2026 Morse Micro
 *
 * SPDX-License-Identifier: Apache-2.0
 */
#pragma once

#include <stdint.h>

/**
 * @brief Run a UDP echo server on the given port. Blocks forever.
 *
 * @param[in] port: UDP port to listen on.
 */
void udp_echo_run(uint16_t port);
```
