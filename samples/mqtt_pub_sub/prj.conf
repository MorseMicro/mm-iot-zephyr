## CMakeLists.txt
```
# Copyright 2025 Morse Micro
# SPDX-License-Identifier: Apache-2.0

cmake_minimum_required(VERSION 3.20.0)

find_package(Zephyr REQUIRED HINTS $ENV{ZEPHYR_BASE})
project(mqtt_pub_sub)

FILE(GLOB app_sources src/*.c)
target_sources(app PRIVATE ${app_sources})
```

## Kconfig
```
# Copyright 2025-2026 Morse Micro
# SPDX-License-Identifier: Apache-2.0

mainmenu "Wi-Fi HaLow mqtt_pub_sub application"

config WIFI_SSID
    string "Wi-Fi SSID of the AP we want to connect to"
    default "MorseMicro"

config WIFI_PSK
    string "Password of the AP we want to connect to"
    default "12345678"

config MQTT_BROKER_ADDR
    string "Address the MQTT broker is running on"
    default "192.168.12.1"

config MQTT_BROKER_PORT
    int "Port the MQTT broker is running on"
    default 1883

source "Kconfig.zephyr"
```

## sample.yaml
```
# Copyright 2025-2026 Morse Micro
# SPDX-License-Identifier: Apache-2.0

tests:
  # Needs a real DUT, a live AP, and an MQTT broker reachable from it.
  mqtt_pub_sub.run:
    platform_allow:
      - mm6108_ekh05
      - mm8108_ekh05
    build_only: false
    build_on_all: false
    integration_platforms:
      - mm6108_ekh05
      - mm8108_ekh05
    harness: console
    harness_config:
      type: multi_line
      ordered: true
      regex:
        - "Wi-Fi connected"
        - "net_dhcpv4: Received"
        - "net_mqtt: Connect completed"
        - "MQTT connected"
        - "Received message on topic twister/output"
        - "Wi-Fi disconnected"
    tags:
      - wifi
      - morsemicro
  mqtt_pub_sub.run.shield:
    platform_allow:
      - nucleo_u575zi_q
    build_only: false
    build_on_all: false
    extra_args: SHIELD=morsemicro_mmech08
    harness: console
    harness_config:
      type: multi_line
      ordered: true
      regex:
        - "Wi-Fi connected"
        - "net_dhcpv4: Received"
        - "net_mqtt: Connect completed"
        - "MQTT connected"
        - "Received message on topic twister/output"
        - "Wi-Fi disconnected"
    tags:
      - shield
      - wifi
      - morse

  # Build-only companion: gives CI compile coverage for this sample without
  # needing a DUT/AP/MQTT broker.
  mqtt_pub_sub.build:
    platform_allow:
      - mm6108_ekh05
      - mm8108_ekh05
    build_only: true
    tags:
      - wifi
      - morsemicro
      - build-only

  mqtt_pub_sub.build.shield.mmech08.nucleo_u575zi_q:
    platform_allow:
      - nucleo_u575zi_q
    build_only: true
    extra_args: SHIELD=morsemicro_mmech08
    tags:
      - shield
      - wifi
      - morsemicro
      - build-only

  mqtt_pub_sub.build.shield.mmech08.nucleo_h753zi:
    platform_allow:
      - nucleo_h753zi
    build_only: true
    extra_args: SHIELD=morsemicro_mmech08
    tags:
      - shield
      - wifi
      - morsemicro
      - build-only

  mqtt_pub_sub.build.shield.mmech08.ek_ra6m5:
    platform_allow:
      - ek_ra6m5
    build_only: true
    extra_args: SHIELD=morsemicro_mmech08
    tags:
      - shield
      - wifi
      - morsemicro
      - build-only

  mqtt_pub_sub.build.shield.mmech18.nucleo_u575zi_q:
    platform_allow:
      - nucleo_u575zi_q
    build_only: true
    extra_args: SHIELD=morsemicro_mmech18
    tags:
      - shield
      - wifi
      - morsemicro
      - build-only

  mqtt_pub_sub.build.shield.mmech18.nucleo_h753zi:
    platform_allow:
      - nucleo_h753zi
    build_only: true
    extra_args: SHIELD=morsemicro_mmech18
    tags:
      - shield
      - wifi
      - morsemicro
      - build-only

  mqtt_pub_sub.build.shield.mmech18.ek_ra6m5:
    platform_allow:
      - ek_ra6m5
    build_only: true
    extra_args: SHIELD=morsemicro_mmech18
    tags:
      - shield
      - wifi
      - morsemicro
      - build-only
```

## prj.conf
```kconfig
# Copyright 2025 Morse Micro
# SPDX-License-Identifier: Apache-2.0

CONFIG_NETWORKING=y
CONFIG_TEST_RANDOM_GENERATOR=y

CONFIG_NET_TX_STACK_SIZE=2048
CONFIG_NET_RX_STACK_SIZE=2048
CONFIG_NET_PKT_RX_COUNT=10
CONFIG_NET_BUF_RX_COUNT=20
CONFIG_NET_PKT_TX_COUNT=10
CONFIG_NET_BUF_TX_COUNT=20
CONFIG_NET_MAX_CONTEXTS=10
CONFIG_NET_DHCPV4=y
CONFIG_NET_IPV4=y
CONFIG_NET_IPV6=n
CONFIG_NET_TCP=y
CONFIG_NET_UDP=y
CONFIG_NET_STATISTICS=y
CONFIG_NET_STATISTICS_PERIODIC_OUTPUT=n
CONFIG_NET_SOCKETS=y
CONFIG_NET_SOCKETS_POLL_MAX=1

CONFIG_INIT_STACKS=y
CONFIG_MAIN_STACK_SIZE=2048
CONFIG_HEAP_MEM_POOL_SIZE=16384

CONFIG_WIFI=y

CONFIG_MQTT_LIB=y

CONFIG_LOG=y
CONFIG_NET_LOG=y
CONFIG_LOG_DEFAULT_LEVEL=3
CONFIG_WIFI_LOG_LEVEL_ERR=y
```

## src/main.c
```c
/*
 * Copyright (c) 2016 Intel Corporation.
 * Copyright (c) 2025-2026 Morse Micro
 *
 * SPDX-License-Identifier: Apache-2.0
 */

#include <zephyr/kernel.h>
#include <zephyr/net/socket.h>
#include <zephyr/net/mqtt.h>
#include <zephyr/net/net_mgmt.h>
#include <zephyr/net/net_event.h>
#include <zephyr/logging/log.h>
#include <zephyr/net/net_if.h>
#include <zephyr/net/net_ip.h>
#include <zephyr/drivers/sensor.h>
#include <zephyr/random/random.h>
#include <zephyr/net/wifi_mgmt.h>
#include <zephyr/net/net_if.h>

#include "mqtt.h"

LOG_MODULE_REGISTER(mqtt_pub_sub, LOG_LEVEL_INF);

BUILD_ASSERT(strcmp(CONFIG_WIFI_MORSEMICRO_REGION, "00") != 0,
	     "Non interactive samples need CONFIG_WIFI_MORSEMICRO_REGION set to function");

extern struct mqtt_client client;

bool done = false;

#if CONFIG_PM
#define PM_SLEEP_DURATION 15
#endif /* CONFIG_PM */

int main(void)
{
	int rc = wifi_connect_blocking();
	if (rc) {
		LOG_ERR("wifi_connect_blocking: %d", rc);
		return rc;
	}

	rc = wait_for_network();
	if (rc) {
		LOG_ERR("Network not ready: %d", rc);
		return rc;
	}

	rc = init_mqtt();
	if (rc) {
		LOG_ERR("Could not set up MQTT broker");
		return rc;
	}
	char payload[256];
	snprintf(payload, sizeof(payload), "board=%s", CONFIG_BOARD);
	while (!done) {
		struct mqtt_publish_param param = {0};
		param.message.topic.topic.utf8 = (uint8_t *)MQTT_TOPIC;
		param.message.topic.topic.size = strlen(MQTT_TOPIC);
		param.message.topic.qos = MQTT_QOS_0_AT_MOST_ONCE;
		param.message.payload.data = payload;
		param.message.payload.len = strlen(payload);
		param.message_id = 0;
		param.dup_flag = 0;
		param.retain_flag = 0;
		int rc = mqtt_publish(&client, &param);
		if (rc < 0) {
			LOG_ERR("MQTT_PUBLISH FAILED %d", rc);
			return rc;
		}
		(void)mqtt_input(&client);
		(void)mqtt_live(&client);
		k_sleep(K_MSEC(1000));
	}

#if CONFIG_PM
	k_sleep(K_SECONDS(PM_SLEEP_DURATION));
#endif /* CONFIG_PM */
	rc = wifi_disconnect_blocking();
	if (rc) {
		LOG_ERR("Could not disconnect");
		return rc;
	}
	return rc;
}
```

## src/mqtt.c
```c
/*
 * Copyright 2025 Morse Micro
 *
 * SPDX-License-Identifier: Apache-2.0
 */

#include "mqtt.h"

LOG_MODULE_REGISTER(mqtt_pub_sub_NETWORKING);

static K_SEM_DEFINE(wifi_conn_sem, 0, 1);
static K_SEM_DEFINE(wifi_disconn_sem, 0, 1);
static K_SEM_DEFINE(net_ready, 0, 1);
static K_SEM_DEFINE(mqtt_conn_sem, 0, 1);

static struct net_mgmt_event_callback wifi_cb;
static struct net_mgmt_event_callback ipv4_cb;
static atomic_t mqtt_is_connected;

extern bool done;

#define BUFFER_SIZE 256
static uint8_t rx_payload_buf[BUFFER_SIZE];
static uint8_t rx_buffer[BUFFER_SIZE];
static uint8_t tx_buffer[BUFFER_SIZE];

/* Global structs */
struct mqtt_client client;
static struct sockaddr_storage broker;
static struct mqtt_topic subscribe_topic = {
	.topic =
		{
			.utf8 = MQTT_SUB_TOPIC,
			.size = sizeof(MQTT_SUB_TOPIC) - 1,
		},
	.qos = MQTT_QOS_1_AT_LEAST_ONCE,
};

static struct mqtt_subscription_list sub_list = {
	.list = &subscribe_topic,
	.list_count = 1,
	.message_id = 1,
};

static void wifi_mgmt_event(struct net_mgmt_event_callback *cb, uint64_t mgmt_event,
			    struct net_if *iface)
{
	if (mgmt_event == NET_EVENT_WIFI_CONNECT_RESULT) {
		const struct wifi_status *status = (const struct wifi_status *)cb->info;
		if (status && status->status == WIFI_STATUS_CONN_SUCCESS) {
			LOG_INF("Wi-Fi connected");
			k_sem_give(&wifi_conn_sem);
		} else {
			LOG_ERR("Wi-Fi connect failed: %d", status ? status->status : -1);
		}
	} else if (mgmt_event == NET_EVENT_WIFI_DISCONNECT_RESULT) {
		const struct wifi_status *status = (const struct wifi_status *)cb->info;
		LOG_INF("Wi-Fi disconnected (%d)", status ? status->status : -1);
		k_sem_give(&wifi_disconn_sem);
	}
}

int wifi_connect_blocking(void)
{
	struct net_if *iface = net_if_get_first_wifi();
	if (!iface) {
		LOG_ERR("No Wi-Fi interface");
		return -ENODEV;
	}

	net_mgmt_init_event_callback(&wifi_cb, wifi_mgmt_event,
				     NET_EVENT_WIFI_CONNECT_RESULT |
					     NET_EVENT_WIFI_DISCONNECT_RESULT);
	net_mgmt_add_event_callback(&wifi_cb);

	struct wifi_connect_req_params cp = {0};
	cp.ssid = WIFI_SSID;
	cp.ssid_length = strlen(WIFI_SSID);
	cp.psk = WIFI_PSK;
	cp.psk_length = strlen(WIFI_PSK);
	cp.channel = WIFI_CHANNEL_ANY;
	cp.security = WIFI_SECURITY;
	cp.mfp = WIFI_MFP_OPTIONAL;

	LOG_INF("Joining SSID: %s ...", WIFI_SSID);
	int rc = net_mgmt(NET_REQUEST_WIFI_CONNECT, iface, &cp, sizeof(cp));
	if (rc) {
		LOG_ERR("Wi-Fi connect request failed: %d", rc);
		return rc;
	}

	if (k_sem_take(&wifi_conn_sem, K_MSEC(WIFI_TIMEOUT_MS)) != 0) {
		LOG_ERR("Wi-Fi connect timeout");
		return -ETIMEDOUT;
	}
	return 0;
}

int wifi_disconnect_blocking(void)
{
	struct net_if *iface = net_if_get_first_wifi();
	if (!iface) {
		LOG_ERR("No Wi-Fi interface");
		return -ENODEV;
	}

	int rc = net_mgmt(NET_REQUEST_WIFI_DISCONNECT, iface, NULL, 0);

	if (k_sem_take(&wifi_disconn_sem, K_MSEC(WIFI_TIMEOUT_MS)) != 0) {
		LOG_ERR("Wi-Fi disconnect timeout");
		return -ETIMEDOUT;
	}
	return rc;
}

static void ipv4_event_handler(struct net_mgmt_event_callback *cb, uint64_t mgmt_event,
			       struct net_if *iface)
{
	ARG_UNUSED(cb);
	ARG_UNUSED(iface);

	if (mgmt_event == NET_EVENT_IPV4_ADDR_ADD) {
		k_sem_give(&net_ready);
	}
}

int wait_for_network(void)
{
	/* Fire once if already configured, otherwise wait for DHCP. */
	net_mgmt_init_event_callback(&ipv4_cb, ipv4_event_handler, NET_EVENT_IPV4_ADDR_ADD);
	net_mgmt_add_event_callback(&ipv4_cb);

	/* If the interface is already up with an IPv4 address, skip wait. */
	struct net_if *iface = net_if_get_default();
	if (iface && net_if_flag_is_set(iface, NET_IF_UP) &&
	    net_if_ipv4_get_global_addr(iface, NET_ADDR_PREFERRED)) {
		return 0;
	}

	LOG_INF("Waiting for IPv4 address via DHCP…");
	if (k_sem_take(&net_ready, K_SECONDS(30)) == 0) {
		return 0;
	}
	LOG_ERR("No IPv4 address within timeout");
	return -ETIMEDOUT;
}

static void process_resp(struct mqtt_client *const c, const struct mqtt_evt *evt)
{
	const struct mqtt_publish_param *p = &evt->param.publish;
	LOG_INF("Received message on topic %.*s", evt->param.publish.message.topic.topic.size,
		evt->param.publish.message.topic.topic.utf8);
	if (p->message.payload.len > BUFFER_SIZE) {
		LOG_WRN("Payload too big, truncating");
	}
	uint32_t read_len = MIN(p->message.payload.len, BUFFER_SIZE);

	(void)mqtt_input(c);
	int rc = mqtt_read_publish_payload(c, rx_payload_buf, read_len);
	if (rc < 0) {
		LOG_ERR("mqtt_read_publish_payload failed: %d", rc);
		return;
	}

	/* Null terminate so we can log as string */
	rx_payload_buf[rc] = '\0';
	LOG_INF("Payload: %s", rx_payload_buf);
	done = true;
}

static void mqtt_evt_handler(struct mqtt_client *const c, const struct mqtt_evt *evt)
{
	switch (evt->type) {
	case MQTT_EVT_CONNACK:
		if (evt->result == 0) {
			mqtt_subscribe(&client, &sub_list);
			atomic_set(&mqtt_is_connected, 1);
			k_sem_give(&mqtt_conn_sem);
			LOG_INF("MQTT connected");
		} else {
			LOG_ERR("CONNACK error: %d", evt->result);
		}
		break;
	case MQTT_EVT_DISCONNECT:
		atomic_clear(&mqtt_is_connected);
		LOG_INF("MQTT disconnected (%d)", evt->result);
		break;
	case MQTT_EVT_SUBACK:
		LOG_INF("Subscribed to topic");
		break;
	case MQTT_EVT_PUBLISH:
		process_resp(c, evt);
		break;

	default:
		break;
	}
}

static int resolve_broker(struct sockaddr_storage *broker)
{
	struct sockaddr_in *broker4 = (struct sockaddr_in *)broker;

	memset(broker, 0, sizeof(*broker));
	broker4->sin_family = AF_INET;
	broker4->sin_port = htons(BROKER_PORT);

	int rc = net_addr_pton(AF_INET, BROKER_ADDR, &broker4->sin_addr);
	return rc;
}

int init_mqtt()
{

	int rc = resolve_broker(&broker);
	if (rc) {
		LOG_ERR("Invalid broker address (rc=%d): %s", rc, BROKER_ADDR);
		return rc;
	}

	mqtt_client_init(&client);

	client.broker = (struct sockaddr *)&broker;
	client.evt_cb = mqtt_evt_handler;
	client.client_id.utf8 = (uint8_t *)MQTT_CLIENTID;
	client.client_id.size = strlen(MQTT_CLIENTID);
	client.password = NULL;
	client.user_name = NULL;
	client.protocol_version = MQTT_VERSION_3_1_1;

	client.rx_buf = rx_buffer;
	client.rx_buf_size = sizeof(rx_buffer);
	client.tx_buf = tx_buffer;
	client.tx_buf_size = sizeof(tx_buffer);

	client.transport.type = MQTT_TRANSPORT_NON_SECURE;

	LOG_INF("broker: %p", client.broker);
	LOG_INF("client_id size: %d", client.client_id.size);
	LOG_INF("evt_cb: %p", client.evt_cb);

	LOG_INF("Connecting to %s:%d …", BROKER_ADDR, BROKER_PORT);
	rc = mqtt_connect(&client);
	if (rc) {
		LOG_ERR("mqtt_connect failed: %d", rc);
		return rc;
	}

	int64_t deadline = k_uptime_get() + 8000; /* 8s */
	k_sem_take(&mqtt_conn_sem, K_SECONDS(5));
	while (!atomic_get(&mqtt_is_connected) && k_uptime_get() < deadline) {
		int irc = mqtt_input(&client); /* non-blocking */
		if (irc && irc != -EAGAIN) {
			LOG_WRN("mqtt_input: %d", irc);
		}
		(void)mqtt_live(&client);
		k_sleep(K_MSEC(5)); /* small yield */
	}

	if (!atomic_get(&mqtt_is_connected)) {
		LOG_ERR("MQTT connect timeout");
		(void)mqtt_disconnect(&client, NULL);
		return rc;
	}
	return 0;
}
```

## src/mqtt.h
```c
/*
 * Copyright 2025 Morse Micro
 *
 * SPDX-License-Identifier: Apache-2.0
 */

#ifndef __MQTT_H__
#define __MQTT_H__
#include <zephyr/net/socket.h>
#include <zephyr/net/mqtt.h>
#include <zephyr/net/net_mgmt.h>
#include <zephyr/net/net_event.h>
#include <zephyr/logging/log.h>
#include <zephyr/net/net_if.h>
#include <zephyr/net/net_ip.h>
#include <zephyr/random/random.h>
#include <zephyr/net/wifi_mgmt.h>
#include <inttypes.h>

/* MQTT definitions */
#define BROKER_ADDR    CONFIG_MQTT_BROKER_ADDR
#define BROKER_PORT    CONFIG_MQTT_BROKER_PORT
#define MQTT_CLIENTID  CONFIG_BOARD "_client"
#define MQTT_TOPIC     "twister/input"
#define MQTT_SUB_TOPIC "twister/output"

/* WiFi definitions */
#define WIFI_SSID CONFIG_WIFI_SSID
#define WIFI_PSK  CONFIG_WIFI_PSK

#define WIFI_SECURITY   WIFI_SECURITY_TYPE_SAE
#define WIFI_TIMEOUT_MS 15000

int wifi_connect_blocking(void);
int wait_for_network(void);
int init_mqtt();
int wifi_disconnect_blocking(void);

#endif // __MQTT_H__
```
