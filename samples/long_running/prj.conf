## CMakeLists.txt
```
# Copyright 2025-2026 Morse Micro
# SPDX-License-Identifier: Apache-2.0

cmake_minimum_required(VERSION 3.20.0)

find_package(Zephyr REQUIRED HINTS $ENV{ZEPHYR_BASE})
project(long_running)

FILE(GLOB app_sources src/*.c)
target_sources(app PRIVATE ${app_sources})
```

## Kconfig
```
# Copyright 2025-2026 Morse Micro
# SPDX-License-Identifier: Apache-2.0

mainmenu "Wi-Fi HaLow long_running application"

config WIFI_SSID
    string "Wi-Fi SSID of the AP we want to connect to"
    default "MorseMicro"

config WIFI_PSK
    string "Password of the AP we want to connect to"
    default "12345678"

config TCP_SERVER_IP
    string "TCP server IP address"
    default "192.168.12.1"
    help
        IP of the TCP server receiving the 17-byte payloads.
        Start a listener with: nc -lk <port>

config TCP_SERVER_PORT
    int "TCP server port"
    default 9999
    range 1 65535

config TEST_DURATION
    int "How long the test will run for (in milliseconds)"
    default 600000 # 10 minutes
    range 1000 2147483647 # 1 second -> 24 days

config PAYLOAD_SIZE
    int "How large TX payload is (in bytes)"
    default 32

source "Kconfig.zephyr"
```

## prj.conf
```kconfig
# Copyright 2025-2026 Morse Micro
# SPDX-License-Identifier: Apache-2.0

CONFIG_NETWORKING=y
CONFIG_NET_DHCPV4=y
CONFIG_NET_IPV4=y
CONFIG_NET_IPV6=n
CONFIG_NET_TCP=y
CONFIG_NET_UDP=y

CONFIG_MAIN_STACK_SIZE=2048
CONFIG_HEAP_MEM_POOL_SIZE=16384

CONFIG_WIFI=y

CONFIG_LOG=y
```

## src/main.c
```c
/*
 * Copyright (c) 2016 Intel Corporation.
 * Copyright (c) 2026 Morse Micro
 *
 * SPDX-License-Identifier: Apache-2.0
 */

#include <zephyr/kernel.h>
#include <zephyr/net/socket.h>
#include <zephyr/net/net_mgmt.h>
#include <zephyr/net/net_event.h>
#include <zephyr/logging/log.h>
#include <zephyr/net/net_if.h>
#include <zephyr/net/net_ip.h>
#include <zephyr/drivers/sensor.h>
#include <zephyr/random/random.h>
#include <zephyr/net/wifi_mgmt.h>
#include <zephyr/net/net_if.h>
#include <errno.h>
#include <string.h>

#include "wifi.h"

LOG_MODULE_REGISTER(long_runnning, LOG_LEVEL_INF);

BUILD_ASSERT(strcmp(CONFIG_WIFI_MORSEMICRO_REGION, "00") != 0,
	     "Non interactive samples need CONFIG_WIFI_MORSEMICRO_REGION set to function");

#define PAYLOAD_SIZE CONFIG_PAYLOAD_SIZE

static inline void fill_buffer_with_pattern(uint8_t *buffer, size_t buffer_size,
					    const uint8_t *pattern, size_t pattern_size)
{
	size_t offset = 0;

	/* Copy pattern repeatedly until we reach the buffer end */
	while (offset < buffer_size) {
		size_t remaining = buffer_size - offset;
		size_t copy_size = (remaining < pattern_size) ? remaining : pattern_size;

		memcpy(buffer + offset, pattern, copy_size);
		offset += copy_size;
	}
}

int main(void)
{
	int sock = 0;
	int rc = 0;

	init_net_mgmt();

	rc = wifi_connect_blocking();
	if (rc) {
		LOG_ERR("wifi_connect_blocking: %d", rc);
		return rc;
	}

	rc = wait_for_network();
	if (rc) {
		LOG_ERR("Network not ready: %d", rc);
		return rc;
	}

	sock = zsock_socket(AF_INET, SOCK_STREAM, IPPROTO_TCP);
	if (sock < 0) {
		LOG_ERR("Failed to create socket (%d)", errno);
		return sock;
	}

	struct sockaddr_in addr = {
		.sin_family = AF_INET,
		.sin_port = htons(TCP_SERVER_PORT),
	};

	rc = zsock_inet_pton(AF_INET, TCP_SERVER_IP, &addr.sin_addr);
	if (rc != 1) {
		printk("server: inet_pton failed\n");
		return rc;
	}

	rc = zsock_connect(sock, (struct sockaddr *)&addr, sizeof(addr));
	if (rc) {
		LOG_ERR("Failed to connect: %d, errno: %d (%s)", rc, errno, strerror(errno));
		return rc;
	}
	LOG_INF("Connected to TCP Server");

	uint8_t data[PAYLOAD_SIZE];
	const char *pattern = "MORSE: hello world!\n";
	fill_buffer_with_pattern(data, PAYLOAD_SIZE, pattern, strlen(pattern));

	const int64_t finished = k_uptime_get() + CONFIG_TEST_DURATION;

	while (k_uptime_get() < finished) {
		LOG_DBG("Sending payload of size %d...", PAYLOAD_SIZE);
		rc = zsock_send(sock, data, PAYLOAD_SIZE, 0);
		if (rc < 0) {
			LOG_ERR("Unable to send data, errno: %d (%s)", errno, strerror(errno));
			break;
		}
		k_sleep(K_MSEC(1000));
	}

	rc = zsock_close(sock);
	if (rc) {
		LOG_ERR("Failed to close socket: %d, errno: %d (%s)", rc, errno, strerror(errno));
	}

	rc = wifi_disconnect_blocking();
	if (rc) {
		LOG_ERR("Failed to disconnect from AP");
		return rc;
	}
	return rc;
}
```

## src/config.h
```c
/*
 * Copyright 2026 Morse Micro
 *
 * SPDX-License-Identifier: Apache-2.0
 */
#pragma once

/* Wi-Fi definitions */
#define WIFI_SSID CONFIG_WIFI_SSID
#define WIFI_PSK  CONFIG_WIFI_PSK

#define WIFI_SECURITY   WIFI_SECURITY_TYPE_SAE
#define WIFI_TIMEOUT_MS 15000

/* TCP Server definitions */
#define TCP_SERVER_IP   CONFIG_TCP_SERVER_IP
#define TCP_SERVER_PORT CONFIG_TCP_SERVER_PORT
```

## src/wifi.c
```c
/*
 * Copyright 2025-2026 Morse Micro
 *
 * SPDX-License-Identifier: Apache-2.0
 */

#include "wifi.h"

LOG_MODULE_REGISTER(morsemicro_WIFI);

static K_SEM_DEFINE(wifi_conn_sem, 0, 1);
static K_SEM_DEFINE(wifi_disconn_sem, 0, 1);
static K_SEM_DEFINE(wifi_scan_sem, 0, 1);
static K_SEM_DEFINE(net_ready, 0, 1);

static struct net_mgmt_event_callback wifi_cb;
static struct net_mgmt_event_callback ipv4_cb;

static void ipv4_event_handler(struct net_mgmt_event_callback *cb, uint64_t mgmt_event,
			       struct net_if *iface)
{
	ARG_UNUSED(cb);
	ARG_UNUSED(iface);

	if (mgmt_event == NET_EVENT_IPV4_ADDR_ADD) {
		k_sem_give(&net_ready);
	}
}

static void wifi_mgmt_event(struct net_mgmt_event_callback *cb, uint64_t mgmt_event,
			    struct net_if *iface)
{
	if (mgmt_event == NET_EVENT_WIFI_CONNECT_RESULT) {
		const struct wifi_status *status = (const struct wifi_status *)cb->info;
		if (status && status->status == WIFI_STATUS_CONN_SUCCESS) {
			LOG_INF("Wi-Fi connected");
			k_sem_give(&wifi_conn_sem);
		} else {
			LOG_ERR("Wi-Fi connect failed: %d", status ? status->status : -1);
		}
	} else if (mgmt_event == NET_EVENT_WIFI_DISCONNECT_RESULT) {
		const struct wifi_status *status = (const struct wifi_status *)cb->info;
		LOG_INF("Wi-Fi disconnected (%d)", status ? status->status : -1);
		k_sem_give(&wifi_disconn_sem);
	} else if (mgmt_event == NET_EVENT_WIFI_SCAN_DONE) {
		LOG_INF("Wi-Fi scan completed");
		k_sem_give(&wifi_scan_sem);
	}
}

void init_net_mgmt(void)
{
	net_mgmt_init_event_callback(&wifi_cb, wifi_mgmt_event,
				     (NET_EVENT_WIFI_CONNECT_RESULT |
				      NET_EVENT_WIFI_DISCONNECT_RESULT | NET_EVENT_WIFI_SCAN_DONE));
	net_mgmt_add_event_callback(&wifi_cb);

	net_mgmt_init_event_callback(&ipv4_cb, ipv4_event_handler, NET_EVENT_IPV4_ADDR_ADD);
	net_mgmt_add_event_callback(&ipv4_cb);
}

int wifi_connect_blocking(void)
{
	int rc = 0;

	struct net_if *iface = net_if_get_first_wifi();
	if (!iface) {
		LOG_ERR("No Wi-Fi interface");
		rc = -ENODEV;
		goto finish;
	}

	struct wifi_connect_req_params cp = {0};
	cp.ssid = WIFI_SSID;
	cp.ssid_length = strlen(WIFI_SSID);
	cp.psk = WIFI_PSK;
	cp.psk_length = strlen(WIFI_PSK);
	cp.channel = WIFI_CHANNEL_ANY;
	cp.security = WIFI_SECURITY;
	cp.mfp = WIFI_MFP_OPTIONAL;

	LOG_INF("Joining SSID: %s ...", WIFI_SSID);
	rc = net_mgmt(NET_REQUEST_WIFI_CONNECT, iface, &cp, sizeof(cp));
	if (rc) {
		LOG_ERR("Wi-Fi connect request failed: %d", rc);
		goto finish;
	}

	if (k_sem_take(&wifi_conn_sem, K_MSEC(WIFI_TIMEOUT_MS)) != 0) {
		LOG_ERR("Wi-Fi connect timeout");
		rc = -ETIMEDOUT;
		goto finish;
	}

finish:
	return rc;
}

int wait_for_network(void)
{
	int rc = 0;

	/* If the interface is already up with an IPv4 address, skip wait. */
	struct net_if *iface = net_if_get_default();
	if (iface && net_if_flag_is_set(iface, NET_IF_UP) &&
	    net_if_ipv4_get_global_addr(iface, NET_ADDR_PREFERRED)) {
		goto finish;
	}

	LOG_INF("Waiting for IPv4 address via DHCP…");
	if (k_sem_take(&net_ready, K_SECONDS(30)) != 0) {
		LOG_ERR("No IPv4 address within timeout");
		rc = -ETIMEDOUT;
	}

finish:
	return rc;
}

int wifi_disconnect_blocking(void)
{
	int rc = 0;

	struct net_if *iface = net_if_get_first_wifi();
	if (!iface) {
		LOG_ERR("No Wi-Fi interface");
		rc = -ENODEV;
		goto finish;
	}

	rc = net_mgmt(NET_REQUEST_WIFI_DISCONNECT, iface, NULL, 0);
	if (rc) {
		LOG_ERR("Wi-Fi disconnect request failed: %d", rc);
		goto finish;
	}

	if (k_sem_take(&wifi_disconn_sem, K_MSEC(WIFI_TIMEOUT_MS)) != 0) {
		LOG_ERR("Wi-Fi disconnect timeout");
		rc = -ETIMEDOUT;
		goto finish;
	}

finish:
	return rc;
}

int wifi_scan_blocking(void)
{
	int rc = 0;

	struct net_if *iface = net_if_get_first_wifi();
	if (!iface) {
		LOG_ERR("No Wi-Fi interface");
		rc = -ENODEV;
		goto finish;
	}

	rc = net_mgmt(NET_REQUEST_WIFI_SCAN, iface, NULL, 0);
	if (rc) {
		LOG_ERR("Wi-Fi scan request failed: %d", rc);
		goto finish;
	}

	if (k_sem_take(&wifi_scan_sem, K_MSEC(WIFI_TIMEOUT_MS)) != 0) {
		LOG_ERR("Wi-Fi scan timeout");
		rc = -ETIMEDOUT;
		goto finish;
	}

finish:
	return rc;
}
```

## src/wifi.h
```c
/*
 * Copyright 2025-2026 Morse Micro
 *
 * SPDX-License-Identifier: Apache-2.0
 */

#pragma once

#include <zephyr/posix/sys/socket.h>
#include <zephyr/net/net_mgmt.h>
#include <zephyr/net/net_event.h>
#include <zephyr/logging/log.h>
#include <zephyr/net/net_if.h>
#include <zephyr/net/wifi_mgmt.h>
#include <zephyr/posix/arpa/inet.h>
#include "config.h"

int wifi_connect_blocking(void);
int wait_for_network(void);
int wifi_scan_blocking(void);
void init_net_mgmt(void);
int wifi_disconnect_blocking(void);
```
