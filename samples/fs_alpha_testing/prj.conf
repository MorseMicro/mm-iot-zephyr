## CMakeLists.txt
```
# Copyright 2025 Morse Micro
# SPDX-License-Identifier: Apache-2.0

cmake_minimum_required(VERSION 3.20.0)

find_package(Zephyr REQUIRED HINTS $ENV{ZEPHYR_BASE})
project(fs_alpha_testing)

FILE(GLOB app_sources src/*.c)
target_sources(app PRIVATE ${app_sources})
```

## Kconfig
```
# Copyright 2025 Morse Micro
# SPDX-License-Identifier: Apache-2.0

source "Kconfig.zephyr"

config TEST_REPEAT_COUNT
    int "Number of test iterations"
    default 1
```

## sample.yaml
```
# Copyright 2025 Morse Micro
# SPDX-License-Identifier: Apache-2.0

tests:
  fullstack_alpha_testing.run:
    platform_allow:
      - m2m_u575
    build_only: false
    build_on_all: false
    harness: console
    harness_config:
      type: multi_line
      ordered: true
      regex:
        - "Wi-Fi scan completed"
        - "Wi-Fi connected"
        - "Wi-Fi disconnected"
    tags:
      - wifi
      - morse
      - fs
```

## prj.conf
```kconfig
# Copyright 2025 Morse Micro
# SPDX-License-Identifier: Apache-2.0

CONFIG_NETWORKING=y

CONFIG_NET_DHCPV4=y
CONFIG_NET_IPV4=y
CONFIG_NET_IPV6=n
CONFIG_NET_TCP=y
CONFIG_NET_UDP=y
CONFIG_NET_STATISTICS=y
CONFIG_NET_STATISTICS_PERIODIC_OUTPUT=n
CONFIG_NET_SOCKETS=y
CONFIG_NET_SOCKETS_POLL_MAX=1

CONFIG_INIT_STACKS=y
CONFIG_MAIN_STACK_SIZE=2048
CONFIG_HEAP_MEM_POOL_SIZE=16384

CONFIG_WIFI=y
CONFIG_WIFI_MORSE_FS=y

CONFIG_LOG=y
CONFIG_NET_LOG=y
CONFIG_LOG_DEFAULT_LEVEL=3
CONFIG_WIFI_LOG_LEVEL_ERR=y
```

## src/main.c
```c
/*
 * Copyright (c) 2016 Intel Corporation.
 * Copyright 2025 Morse Micro
 *
 * SPDX-License-Identifier: Apache-2.0
 */

#include <zephyr/kernel.h>
#include <zephyr/net/socket.h>
#include <zephyr/net/mqtt.h>
#include <zephyr/net/net_mgmt.h>
#include <zephyr/net/net_event.h>
#include <zephyr/logging/log.h>
#include <zephyr/net/net_if.h>
#include <zephyr/net/net_ip.h>
#include <zephyr/drivers/sensor.h>
#include <zephyr/random/random.h>
#include <zephyr/net/wifi_mgmt.h>
#include <zephyr/net/net_if.h>

#include "wifi.h"

LOG_MODULE_REGISTER(fs_alpha_testing, LOG_LEVEL_INF);

int main(void)
{
	init_net_mgmt();
	printf("Test count: %d\n", TEST_REPEAT_COUNT);

	for (size_t i = 0; i < TEST_REPEAT_COUNT; i++) {
		LOG_INF("Running test %d", i);
		int rc = wifi_scan_blocking();
		if (rc) {
			LOG_ERR("wifi_connect blocking: %d", rc);
			return rc;
		}

		rc = wifi_connect_blocking();
		if (rc) {
			LOG_ERR("wifi_connect_blocking: %d", rc);
			return rc;
		}

		rc = wait_for_network();
		if (rc) {
			LOG_ERR("Network not ready: %d", rc);
			return rc;
		}

		rc = wifi_disconnect_blocking();
		if (rc) {
			LOG_ERR("Could not disconnect");
			return rc;
		}
		LOG_INF("Test %d completed.", i);
	}
	LOG_INF("%d tests completed.", TEST_REPEAT_COUNT);
	return 0;
}
```

## src/wifi.c
```c
/*
 * Copyright (c) 2016 Intel Corporation.
 * Copyright 2025 Morse Micro
 *
 * SPDX-License-Identifier: Apache-2.0
 */

#include "wifi.h"

LOG_MODULE_REGISTER(fs_alpha_testing_NETWORKING);

static K_SEM_DEFINE(wifi_conn_sem, 0, 1);
static K_SEM_DEFINE(wifi_disconn_sem, 0, 1);
static K_SEM_DEFINE(wifi_scan_sem, 0, 1);
static K_SEM_DEFINE(net_ready, 0, 1);

static struct net_mgmt_event_callback wifi_cb;
static struct net_mgmt_event_callback ipv4_cb;

static void ipv4_event_handler(struct net_mgmt_event_callback *cb, uint32_t mgmt_event,
                               struct net_if *iface)
{
	ARG_UNUSED(cb);
	ARG_UNUSED(iface);

	if (mgmt_event == NET_EVENT_IPV4_ADDR_ADD) {
		k_sem_give(&net_ready);
	}
}

static void wifi_mgmt_event(struct net_mgmt_event_callback *cb, uint32_t mgmt_event,
                            struct net_if *iface)
{
	if (mgmt_event == NET_EVENT_WIFI_CONNECT_RESULT) {
		const struct wifi_status *status = (const struct wifi_status *)cb->info;
		if (status && status->status == WIFI_STATUS_CONN_SUCCESS) {
			LOG_INF("Wi-Fi connected");
			k_sem_give(&wifi_conn_sem);
		} else {
			LOG_ERR("Wi-Fi connect failed: %d", status ? status->status : -1);
		}
	} else if (mgmt_event == NET_EVENT_WIFI_DISCONNECT_RESULT) {
		const struct wifi_status *status = (const struct wifi_status *)cb->info;
		LOG_INF("Wi-Fi disconnected (%d)", status ? status->status : -1);
		k_sem_give(&wifi_disconn_sem);
	} else if (mgmt_event == NET_EVENT_WIFI_SCAN_DONE) {
		LOG_INF("Wi-Fi scan completed");
		k_sem_give(&wifi_scan_sem);
	}
}

void init_net_mgmt(void)
{
	net_mgmt_init_event_callback(&wifi_cb, wifi_mgmt_event,
	                             NET_EVENT_WIFI_CONNECT_RESULT |
	                                     NET_EVENT_WIFI_DISCONNECT_RESULT |
	                                     NET_EVENT_WIFI_SCAN_RESULT);
	net_mgmt_add_event_callback(&wifi_cb);

	net_mgmt_init_event_callback(&ipv4_cb, ipv4_event_handler, NET_EVENT_IPV4_ADDR_ADD);
	net_mgmt_add_event_callback(&ipv4_cb);
}

int wifi_connect_blocking(void)
{
	int rc = 0;

	struct net_if *iface = net_if_get_first_wifi();
	if (!iface) {
		LOG_ERR("No Wi-Fi interface");
		rc = -ENODEV;
		goto finish;
	}

	struct wifi_connect_req_params cp = {0};
	cp.ssid = WIFI_SSID;
	cp.ssid_length = strlen(WIFI_SSID);
	cp.psk = WIFI_PSK;
	cp.psk_length = strlen(WIFI_PSK);
	cp.channel = WIFI_CHANNEL_ANY;
	cp.security = WIFI_SECURITY;
	cp.mfp = WIFI_MFP_OPTIONAL;

	LOG_INF("Joining SSID: %s ...", WIFI_SSID);
	rc = net_mgmt(NET_REQUEST_WIFI_CONNECT, iface, &cp, sizeof(cp));
	if (rc) {
		LOG_ERR("Wi-Fi connect request failed: %d", rc);
		goto finish;
	}

	if (k_sem_take(&wifi_conn_sem, K_MSEC(WIFI_TIMEOUT_MS)) != 0) {
		LOG_ERR("Wi-Fi connect timeout");
		rc = -ETIMEDOUT;
		goto finish;
	}

finish:
	return rc;
}

int wait_for_network(void)
{
	int rc = 0;

	/* If the interface is already up with an IPv4 address, skip wait. */
	struct net_if *iface = net_if_get_default();
	if (iface && net_if_flag_is_set(iface, NET_IF_UP) &&
	    net_if_ipv4_get_global_addr(iface, NET_ADDR_PREFERRED)) {
		goto finish;
	}

	LOG_INF("Waiting for IPv4 address via DHCP…");
	if (k_sem_take(&net_ready, K_SECONDS(30)) != 0) {
		LOG_ERR("No IPv4 address within timeout");
		rc = -ETIMEDOUT;	
	}

finish:
	return rc;
}

int wifi_disconnect_blocking(void)
{
	int rc = 0;

	struct net_if *iface = net_if_get_first_wifi();
	if (!iface) {
		LOG_ERR("No Wi-Fi interface");
		rc = -ENODEV;
		goto finish;
	}

	rc = net_mgmt(NET_REQUEST_WIFI_DISCONNECT, iface, NULL, 0);
	if (rc) {
		LOG_ERR("Wi-Fi disconnect request failed: %d", rc);
		goto finish;
	}

	if (k_sem_take(&wifi_disconn_sem, K_MSEC(WIFI_TIMEOUT_MS)) != 0) {
		LOG_ERR("Wi-Fi disconnect timeout");
		rc = -ETIMEDOUT;
		goto finish;
	}

finish:
	return rc;
}

int wifi_scan_blocking(void)
{
	int rc = 0;

	struct net_if *iface = net_if_get_first_wifi();
	if (!iface) {
		LOG_ERR("No Wi-Fi interface");
		rc = -ENODEV;
		goto finish;
	}

	rc = net_mgmt(NET_REQUEST_WIFI_SCAN, iface, NULL, 0);
	if (rc) {
		LOG_ERR("Wi-Fi scan request failed: %d", rc);
		goto finish;
	}

	if (k_sem_take(&wifi_scan_sem, K_MSEC(WIFI_TIMEOUT_MS)) != 0) {
		LOG_ERR("Wi-Fi scan timeout");
		rc = -ETIMEDOUT;
		goto finish;
	}

finish:
	return rc;
}
```

## src/wifi.h
```c
/*
 * Copyright 2025 Morse Micro
 *
 * SPDX-License-Identifier: Apache-2.0
 */

#ifndef __WIFI_H__
#define __WIFI_H__

#include <zephyr/net/socket.h>
#include <zephyr/net/mqtt.h>
#include <zephyr/net/net_mgmt.h>
#include <zephyr/net/net_event.h>
#include <zephyr/logging/log.h>
#include <zephyr/net/net_if.h>
#include <zephyr/net/net_ip.h>
#include <zephyr/random/random.h>
#include <zephyr/net/wifi_mgmt.h>

#define TEST_REPEAT_COUNT CONFIG_TEST_REPEAT_COUNT

/* WiFi definitions */
#ifndef WIFI_SSID
#define WIFI_SSID "MorseMicro"
#endif

#ifndef WIFI_PSK
#define WIFI_PSK "12345678"
#endif

#define WIFI_SECURITY   WIFI_SECURITY_TYPE_SAE
#define WIFI_TIMEOUT_MS 15000

int wifi_connect_blocking(void);
int wait_for_network(void);
int wifi_scan_blocking(void);
void init_net_mgmt(void);
int wifi_disconnect_blocking(void);

#endif // __WIFI_H__
```
