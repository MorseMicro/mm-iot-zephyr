## CMakeLists.txt
```
# Copyright 2026 Morse Micro
# SPDX-License-Identifier: Apache-2.0

cmake_minimum_required(VERSION 3.20.0)

find_package(Zephyr REQUIRED HINTS $ENV{ZEPHYR_BASE})
project(udp_client)

FILE(GLOB app_sources src/*.c)
target_sources(app PRIVATE ${app_sources})
```

## Kconfig
```
# Copyright 2026 Morse Micro
# SPDX-License-Identifier: Apache-2.0

mainmenu "Wi-Fi HaLow udp application"

config WIFI_SSID
    string "Wi-Fi SSID of the AP we want to connect to"
    default "MorseMicro"

config WIFI_PSK
    string "Password of the AP we want to connect to"
    default "12345678"

config SERVER_PORT_BASE
	int "Open UDP port number on the remote server"
	default 4242

config N_SERVERS
	int "Number of open UDP ports on the server. Increments SERVER_PORT_BASE (e.g. 4242, 4243, 4244, ..., 4251)"
	default 10

config NUM_PKTS
	int "Number of UDP packets to send"
	default 32

source "Kconfig.zephyr"
```

## prj.conf
```kconfig
# Copyright 2026 Morse Micro
# SPDX-License-Identifier: Apache-2.0

CONFIG_NETWORKING=y

CONFIG_NET_DHCPV4=y
CONFIG_NET_IPV4=y
CONFIG_NET_IPV6=n
CONFIG_NET_TCP=y
CONFIG_NET_UDP=y
CONFIG_NET_STATISTICS=y
CONFIG_NET_STATISTICS_PERIODIC_OUTPUT=n
CONFIG_NET_SOCKETS=y
CONFIG_NET_SOCKETS_POLL_MAX=1

CONFIG_INIT_STACKS=y
CONFIG_MAIN_STACK_SIZE=4096
CONFIG_HEAP_MEM_POOL_SIZE=16384

CONFIG_WIFI=y

CONFIG_LOG=y
CONFIG_NET_LOG=y
CONFIG_LOG_DEFAULT_LEVEL=3
CONFIG_WIFI_LOG_LEVEL_ERR=y

CONFIG_POSIX_API=y

CONFIG_NET_CONFIG_SETTINGS=y
```

## src/main.c
```c
/*
 * Copyright 2026 Morse Micro
 *
 * SPDX-License-Identifier: Apache-2.0
 */

#include <zephyr/kernel.h>

#include "wifi.h"
#include "config.h"

LOG_MODULE_REGISTER(udp_client, LOG_LEVEL_DBG);

BUILD_ASSERT(strcmp(CONFIG_WIFI_MORSEMICRO_REGION, "00") != 0,
	     "Non interactive samples need CONFIG_WIFI_MORSEMICRO_REGION set to function");

int main(void)
{
	int sock = 0;
	struct sockaddr_in servers[N_SERVERS];
	int rc = 0;

	init_net_mgmt();
	rc = wifi_connect_blocking();
	if (rc) {
		LOG_ERR("wifi_connect_blocking: %d", rc);
		return rc;
	}

	rc = wait_for_network();
	if (rc) {
		LOG_ERR("Network not ready: %d", rc);
		return rc;
	}

	sock = socket(AF_INET, SOCK_DGRAM, IPPROTO_UDP);
	if (sock < 0) {
		LOG_ERR("Failed to create socket (%d)", errno);
		return sock;
	}

	for (int i = 0; i < N_SERVERS; i++) {
		servers[i].sin_family = AF_INET;
		servers[i].sin_port = htons(SERVER_PORT_BASE + i);
		inet_pton(AF_INET, SERVER_ADDR, &servers[i].sin_addr);
	}

	for (int i = 0; i < NUM_PKTS; i++) {
		const char *msg = "Hello from Zephyr\n";
		int ret = sendto(sock, msg, strlen(msg), 0,
				 (struct sockaddr *)&servers[i % (N_SERVERS)],
				 sizeof(servers[i % (N_SERVERS)]));

		if (ret < 0) {
			LOG_ERR("sendto failed (%d)", errno);
		} else {
			LOG_INF("Sent UDP packet");
		}

		/* Constantly send to connection 0 to keep it in LRU cache */
		ret = sendto(sock, msg, strlen(msg), 0, (struct sockaddr *)&servers[0],
			     sizeof(servers[0]));

		if (ret < 0) {
			LOG_ERR("sendto failed (%d)", errno);
		} else {
			LOG_INF("Sent UDP packet");
		}

		k_sleep(K_SECONDS(1));
	}
	return 0;
}
```

## src/config.h
```c
/*
 * Copyright 2026 Morse Micro
 *
 * SPDX-License-Identifier: Apache-2.0
 */
#pragma once

/* WiFi definitions */
#ifndef CONFIG_WIFI_SSID
#define WIFI_SSID "MorseMicro"
#else
#define WIFI_SSID CONFIG_WIFI_SSID
#endif

#ifndef CONFIG_WIFI_PSK
#define WIFI_PSK "12345678"
#else
#define WIFI_PSK CONFIG_WIFI_PSK
#endif

#define WIFI_SECURITY   WIFI_SECURITY_TYPE_SAE
#define WIFI_TIMEOUT_MS 15000

#ifndef CONFIG_SERVER_PORT_1
#define SERVER_PORT_1 4242
#else
#define SERVER_PORT_1 CONFIG_SERVER_PORT_1
#endif

#ifndef CONFIG_SERVER_PORT_2
#define SERVER_PORT_2 4243
#else
#define SERVER_PORT_2 CONFIG_SERVER_PORT_2
#endif

#define N_SERVERS   2
#define SERVER_ADDR CONFIG_NET_CONFIG_PEER_IPV4_ADDR
```

## src/wifi.c
```c
/*
 * Copyright 2025-2026 Morse Micro
 *
 * SPDX-License-Identifier: Apache-2.0
 */

#include "wifi.h"

LOG_MODULE_REGISTER(udp_client_NETWORKING);

static K_SEM_DEFINE(wifi_conn_sem, 0, 1);
static K_SEM_DEFINE(wifi_disconn_sem, 0, 1);
static K_SEM_DEFINE(wifi_scan_sem, 0, 1);
static K_SEM_DEFINE(net_ready, 0, 1);

static struct net_mgmt_event_callback wifi_cb;
static struct net_mgmt_event_callback ipv4_cb;

static void ipv4_event_handler(struct net_mgmt_event_callback *cb, uint64_t mgmt_event,
			       struct net_if *iface)
{
	ARG_UNUSED(cb);
	ARG_UNUSED(iface);

	if (mgmt_event == NET_EVENT_IPV4_ADDR_ADD) {
		k_sem_give(&net_ready);
	}
}

static void wifi_mgmt_event(struct net_mgmt_event_callback *cb, uint64_t mgmt_event,
			    struct net_if *iface)
{
	if (mgmt_event == NET_EVENT_WIFI_CONNECT_RESULT) {
		const struct wifi_status *status = (const struct wifi_status *)cb->info;
		if (status && status->status == WIFI_STATUS_CONN_SUCCESS) {
			LOG_INF("Wi-Fi connected");
			k_sem_give(&wifi_conn_sem);
		} else {
			LOG_ERR("Wi-Fi connect failed: %d", status ? status->status : -1);
		}
	} else if (mgmt_event == NET_EVENT_WIFI_DISCONNECT_RESULT) {
		const struct wifi_status *status = (const struct wifi_status *)cb->info;
		LOG_INF("Wi-Fi disconnected (%d)", status ? status->status : -1);
		k_sem_give(&wifi_disconn_sem);
	} else if (mgmt_event == NET_EVENT_WIFI_SCAN_DONE) {
		LOG_INF("Wi-Fi scan completed");
		k_sem_give(&wifi_scan_sem);
	}
}

void init_net_mgmt(void)
{
	net_mgmt_init_event_callback(&wifi_cb, wifi_mgmt_event,
				     (NET_EVENT_WIFI_CONNECT_RESULT |
				      NET_EVENT_WIFI_DISCONNECT_RESULT | NET_EVENT_WIFI_SCAN_DONE));
	net_mgmt_add_event_callback(&wifi_cb);

	net_mgmt_init_event_callback(&ipv4_cb, ipv4_event_handler, NET_EVENT_IPV4_ADDR_ADD);
	net_mgmt_add_event_callback(&ipv4_cb);
}

int wifi_connect_blocking(void)
{
	int rc = 0;

	struct net_if *iface = net_if_get_first_wifi();
	if (!iface) {
		LOG_ERR("No Wi-Fi interface");
		rc = -ENODEV;
		goto finish;
	}

	struct wifi_connect_req_params cp = {0};
	cp.ssid = WIFI_SSID;
	cp.ssid_length = strlen(WIFI_SSID);
	cp.psk = WIFI_PSK;
	cp.psk_length = strlen(WIFI_PSK);
	cp.channel = WIFI_CHANNEL_ANY;
	cp.security = WIFI_SECURITY;
	cp.mfp = WIFI_MFP_OPTIONAL;

	LOG_INF("Joining SSID: %s ...", WIFI_SSID);
	rc = net_mgmt(NET_REQUEST_WIFI_CONNECT, iface, &cp, sizeof(cp));
	if (rc) {
		LOG_ERR("Wi-Fi connect request failed: %d", rc);
		goto finish;
	}

	if (k_sem_take(&wifi_conn_sem, K_MSEC(WIFI_TIMEOUT_MS)) != 0) {
		LOG_ERR("Wi-Fi connect timeout");
		rc = -ETIMEDOUT;
		goto finish;
	}

finish:
	return rc;
}

int wait_for_network(void)
{
	int rc = 0;

	/* If the interface is already up with an IPv4 address, skip wait. */
	struct net_if *iface = net_if_get_default();
	if (iface && net_if_flag_is_set(iface, NET_IF_UP) &&
	    net_if_ipv4_get_global_addr(iface, NET_ADDR_PREFERRED)) {
		goto finish;
	}

	LOG_INF("Waiting for IPv4 address via DHCP…");
	if (k_sem_take(&net_ready, K_SECONDS(30)) != 0) {
		LOG_ERR("No IPv4 address within timeout");
		rc = -ETIMEDOUT;
	}

finish:
	return rc;
}

int wifi_disconnect_blocking(void)
{
	int rc = 0;

	struct net_if *iface = net_if_get_first_wifi();
	if (!iface) {
		LOG_ERR("No Wi-Fi interface");
		rc = -ENODEV;
		goto finish;
	}

	rc = net_mgmt(NET_REQUEST_WIFI_DISCONNECT, iface, NULL, 0);
	if (rc) {
		LOG_ERR("Wi-Fi disconnect request failed: %d", rc);
		goto finish;
	}

	if (k_sem_take(&wifi_disconn_sem, K_MSEC(WIFI_TIMEOUT_MS)) != 0) {
		LOG_ERR("Wi-Fi disconnect timeout");
		rc = -ETIMEDOUT;
		goto finish;
	}

finish:
	return rc;
}

int wifi_scan_blocking(void)
{
	int rc = 0;

	struct net_if *iface = net_if_get_first_wifi();
	if (!iface) {
		LOG_ERR("No Wi-Fi interface");
		rc = -ENODEV;
		goto finish;
	}

	rc = net_mgmt(NET_REQUEST_WIFI_SCAN, iface, NULL, 0);
	if (rc) {
		LOG_ERR("Wi-Fi scan request failed: %d", rc);
		goto finish;
	}

	if (k_sem_take(&wifi_scan_sem, K_MSEC(WIFI_TIMEOUT_MS)) != 0) {
		LOG_ERR("Wi-Fi scan timeout");
		rc = -ETIMEDOUT;
		goto finish;
	}

finish:
	return rc;
}
```

## src/wifi.h
```c
/*
 * Copyright 2025-2026 Morse Micro
 *
 * SPDX-License-Identifier: Apache-2.0
 */

#ifndef __WIFI_H__
#define __WIFI_H__

#include <zephyr/posix/sys/socket.h>
#include <zephyr/net/net_mgmt.h>
#include <zephyr/net/net_event.h>
#include <zephyr/logging/log.h>
#include <zephyr/net/net_if.h>
#include <zephyr/net/wifi_mgmt.h>
#include <zephyr/posix/arpa/inet.h>
#include "config.h"

int wifi_connect_blocking(void);
int wait_for_network(void);
int wifi_scan_blocking(void);
void init_net_mgmt(void);
int wifi_disconnect_blocking(void);

#endif // __WIFI_H__
```
