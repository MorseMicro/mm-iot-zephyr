## CMakeLists.txt
```
# Copyright 2024-2026 Morse Micro
# SPDX-License-Identifier: Apache-2.0

cmake_minimum_required(VERSION 3.20.0)
find_package(Zephyr REQUIRED HINTS $ENV{ZEPHYR_BASE})
project(porting_assistant)

file(GLOB app_sources src/*.c)
target_link_libraries(app PRIVATE libmorse mmutils)
target_sources(app PRIVATE ${app_sources})
```

## sample.yaml
```
# Copyright 2026 Morse Micro
# SPDX-License-Identifier: Apache-2.0

tests:
  porting_assistant.run:
    platform_allow:
      - mm6108_ekh05
      - mm8108_ekh05
    extra_args: CONFIG_COMPILER_WARNINGS_AS_ERRORS=n
    build_only: false
    build_on_all: false
    integration_platforms:
      - mm6108_ekh05
      - mm8108_ekh05
    harness: console
    harness_config:
      type: one_line
      regex:
        - "11 passed"
        - "0 failed"
    tags:
      - wifi
      - morsemicro

  porting_assistant.run.shield:
    platform_allow:
      - nucleo_u575zi_q
    build_only: false
    build_on_all: false
    extra_args:
      - SHIELD=morsemicro_mmech08
      - CONFIG_COMPILER_WARNINGS_AS_ERRORS=n
    harness: console
    harness_config:
      type: one_line
      regex:
        - "11 passed"
        - "0 failed"
    tags:
      - shield
      - wifi
      - morsemicro

  # Build-only companion: gives CI compile coverage for this sample without
  # needing a DUT.
  porting_assistant.build:
    platform_allow:
      - mm6108_ekh05
      - mm8108_ekh05
    build_only: true
    extra_args: CONFIG_COMPILER_WARNINGS_AS_ERRORS=n
    tags:
      - wifi
      - morsemicro
      - build-only

  porting_assistant.build.shield.mmech08.nucleo_u575zi_q:
    platform_allow:
      - nucleo_u575zi_q
    build_only: true
    extra_args:
      - SHIELD=morsemicro_mmech08
      - CONFIG_COMPILER_WARNINGS_AS_ERRORS=n
    tags:
      - shield
      - wifi
      - morsemicro
      - build-only

  porting_assistant.build.shield.mmech08.nucleo_h753zi:
    platform_allow:
      - nucleo_h753zi
    build_only: true
    extra_args:
      - SHIELD=morsemicro_mmech08
      - CONFIG_COMPILER_WARNINGS_AS_ERRORS=n
    tags:
      - shield
      - wifi
      - morsemicro
      - build-only

  porting_assistant.build.shield.mmech08.ek_ra6m5:
    platform_allow:
      - ek_ra6m5
    build_only: true
    extra_args:
      - SHIELD=morsemicro_mmech08
      - CONFIG_COMPILER_WARNINGS_AS_ERRORS=n
    tags:
      - shield
      - wifi
      - morsemicro
      - build-only

  porting_assistant.build.shield.mmech18.nucleo_u575zi_q:
    platform_allow:
      - nucleo_u575zi_q
    build_only: true
    extra_args:
      - SHIELD=morsemicro_mmech18
      - CONFIG_COMPILER_WARNINGS_AS_ERRORS=n
    tags:
      - shield
      - wifi
      - morsemicro
      - build-only

  porting_assistant.build.shield.mmech18.nucleo_h753zi:
    platform_allow:
      - nucleo_h753zi
    build_only: true
    extra_args:
      - SHIELD=morsemicro_mmech18
      - CONFIG_COMPILER_WARNINGS_AS_ERRORS=n
    tags:
      - shield
      - wifi
      - morsemicro
      - build-only

  porting_assistant.build.shield.mmech18.ek_ra6m5:
    platform_allow:
      - ek_ra6m5
    build_only: true
    extra_args:
      - SHIELD=morsemicro_mmech18
      - CONFIG_COMPILER_WARNINGS_AS_ERRORS=n
    tags:
      - shield
      - wifi
      - morsemicro
      - build-only
```

## prj.conf
```kconfig
CONFIG_GPIO=y
CONFIG_NETWORKING=y
CONFIG_WIFI=y
CONFIG_WIFI_MORSEMICRO_TEST=y
CONFIG_SPI=y
CONFIG_HEAP_MEM_POOL_SIZE=131072
CONFIG_FPU=y
CONFIG_MAIN_THREAD_PRIORITY=14
```

## src/config.h
```c
/*
 * Copyright 2023 Morse Micro
 *
 * SPDX-License-Identifier: Apache-2.0
 */
#pragma once

#ifndef TEST_NAME_COLUMN_WIDTH
#define TEST_NAME_COLUMN_WIDTH 40
#endif

#ifndef LOG_COLOR_ENABLED
#define LOG_COLOR_ENABLED 1
#endif
```

## src/mm6108_reg.h
```c
/*
 * Copyright 2024 Morse Micro
 *
 * SPDX-License-Identifier: Apache-2.0
 */

#pragma once


/** Address where the chip ID is stored on the MM6108 */
#define MM6108_REG_CHIP_ID     0x10054d20

#define MM6108_REG_OUT_EN      0x10012008
#define MM6108_REG_OUT_VAL     0x1001200c
```

## src/mmhal_log.c
```c
#include <zephyr/kernel.h>
#include "mmhal.h"

void mmhal_log_write(const uint8_t *data, size_t length) {
	printf(data);
}

void mmhal_log_flush(void){

}
```

## src/porting_assistant.c
```c
/*
 * Copyright 2021-2023 Morse Micro
 *
 * SPDX-License-Identifier: Apache-2.0
 */

/**
 * @file
 * @brief Porting assistant self test tool to validate hardware and HALs.
 *
 * @note It is assumed that you have followed the steps in the @ref GETTING_STARTED guide and are
 * therefore familiar with how to build, flash, and monitor an application using the MM-IoT-SDK
 * framework.
 *
 * The Morse Micro Porting Assistant is a tool that assists with validating OSAL, HALs, and
 * platform hardware necessary for communicating with a Morse Micro chip. It runs a sequence of
 * tests and displays the results of each along with information about potential causes on failure.
 *
 * This tool has been provided as an example application on the Morse Micro reference platforms.
 * Running this application on a known-good platform should result in a 100% pass rate.
 *
 * When bringing up a new platform, it is recommended to first port this example application
 * to your new platform. It will then assist in diagnosing fundamental issues that may be
 * more difficult to identify or debug when using other example applications.
 */

#include "porting_assistant.h"

#if defined(ENABLE_EXT_XTAL_INIT) && ENABLE_EXT_XTAL_INIT
/* The crystal initialization requires chip specific configuration which we do not have access
 * to in the porting assistant example application. */
#error "With ENABLE_EXT_XTAL_INIT defined this device is not supported by porting assistant."
#endif

/* Test step declarations */
extern const struct test_step test_step_os_malloc;                      /**< Test definition */
extern const struct test_step test_step_os_realloc;                     /**< Test definition */
extern const struct test_step test_step_os_time;                        /**< Test definition */
extern const struct test_step test_step_os_task_creation;               /**< Test definition */

extern const struct test_step test_step_mmhal_wlan_init;                /**< Test definition */
extern const struct test_step test_step_mmhal_wlan_hard_reset;          /**< Test definition */
extern const struct test_step test_step_mmhal_wlan_sdio_startup;        /**< Test definition */
extern const struct test_step test_step_read_chip_id;                   /**< Test definition */
extern const struct test_step test_step_bulk_write_read;                /**< Test definition */
extern const struct test_step test_step_raw_tput;                       /**< Test definition */

extern const struct test_step test_step_mmhal_wlan_validate_fw;         /**< Test definition */
extern const struct test_step test_step_mmhal_wlan_validate_bcf;        /**< Test definition */

extern const struct test_step test_step_verify_busy_pin;                /**< Test definition */


/** Array of test steps. */
static const struct test_step * const test_steps[] = {
    &test_step_os_malloc,
    &test_step_os_realloc,
    &test_step_os_time,
    &test_step_os_task_creation,
    &test_step_mmhal_wlan_init,
    &test_step_mmhal_wlan_hard_reset,
    &test_step_mmhal_wlan_sdio_startup,
    &test_step_read_chip_id,
    &test_step_verify_busy_pin,
    &test_step_bulk_write_read,
    &test_step_raw_tput,
    &test_step_mmhal_wlan_validate_fw,
    &test_step_mmhal_wlan_validate_bcf,
};

/** Counters to track test runs. */
struct test_counters
{
    /** Number of tests that did not return a pass/fail result. */
    unsigned no_result;
    /** Number of tests that passed. */
    unsigned pass;
    /** Number of tests that failed. */
    unsigned fail;
};

/**
 * Convert a @c test_result code to string.
 *
 * @param result    The result code.
 *
 * @returns the string representation of the result code (including color if enabled).
 */
static const char *result_code_to_string(enum test_result result)
{
    switch (result)
    {
    case TEST_NO_RESULT:            return "";
    case TEST_PASSED:               return F_GREEN("PASS");
    case TEST_SKIPPED:              return F_BLUE("SKIP");
    case TEST_FAILED:               return F_RED("FAIL");
    case TEST_FAILED_NON_CRITICAL:  return F_YELLOW("FAIL");
    }
    MMOSAL_ASSERT(false);
}

/**
 * Iterate through the given list of test steps and execute until complete or until a
 * critical failure occurs.
 *
 * @param steps         Test steps to execute.
 * @param num_steps     Number of steps to execute.
 * @param ctrs          Test count state to be updated by this function.
 */
static void run_test_steps(const struct test_step * const steps[], size_t num_steps,
                           struct test_counters *ctrs)
{
    static char log_buf[1024];

    size_t ii;
    for (ii = 0; ii < num_steps; ii++)
    {
        const struct test_step *step = steps[ii];
        size_t log_buf_len = sizeof(log_buf);
        log_buf[0] = '\0';

        LOG_PRINTF(F_BOLD("%-60s "), step->description);
        LOG_FLUSH();

        enum test_result result = step->exec(log_buf, log_buf_len);
        if (result != TEST_NO_RESULT)
        {
            LOG_PRINTF("[ %s ]", result_code_to_string(result));
        }
        LOG_WRITE("\n");

        if (log_buf[0] != '\0')
        {
            LOG_WRITE("\n");
            LOG_WRITE(log_buf);
        }

        switch (result)
        {
        case TEST_NO_RESULT:            ctrs->no_result++;  break;
        case TEST_PASSED:               ctrs->pass++;       break;
        case TEST_SKIPPED:                                  break;
        case TEST_FAILED:               ctrs->fail++;       break;
        case TEST_FAILED_NON_CRITICAL:  ctrs->fail++;       break;
        }

        if (result == TEST_FAILED)
        {
            break;
        }
    }
}

/**
 * Main entry point to the application. This will be invoked in a thread once operating system
 * and hardware initialization has completed. It may return, but it does not have to.
 */
void main(void)
{
    /* Having deep sleep enabled can complicate debugging. Given the purpose of this applications
     * is to validate that you can communicate to the MM-Chip it will be disabled by default. */
    mmhal_set_deep_sleep_veto(MMHAL_VETO_ID_APP_MIN);

    struct test_counters ctrs = { 0 };
    unsigned num_tests = sizeof(test_steps)/sizeof(test_steps[0]);

    LOG_WRITE(F_BOLD("\n\nMM-IoT-SDK Porting Assistant\n"));
    LOG_WRITE("----------------------------\n\n");
    run_test_steps(test_steps, num_tests, &ctrs);


    LOG_PRINTF("\n\n%u total test steps. %u passed, %u failed, %u no result, %u skipped\n",
               num_tests, ctrs.pass, ctrs.fail, ctrs.no_result,
               num_tests - ctrs.no_result - ctrs.pass - ctrs.fail);
}
```

## src/test_hal.c
```c
/*
 * Copyright 2023 Morse Micro
 *
 * SPDX-License-Identifier: Apache-2.0
 */

#include "porting_assistant.h"
#include "mmhal.h"
#include "mmutils.h"

TEST_STEP(test_step_enable_leds, "Enable LEDs")
{
    // mmhal_set_led(LED_RED, LED_ON);
    // mmhal_set_led(LED_GREEN, LED_ON);
    // mmhal_set_led(LED_BLUE, LED_ON);

    // TEST_LOG_APPEND("Inspect LEDs (if present/implemented), all should be illuminated.\n\n");

    /* There is no way for us to validate that the LEDs turned on so the USER needs to check */
    return TEST_NO_RESULT;
}
```

## src/test_os.c
```c
/*
 * Copyright 2023 Morse Micro
 *
 * SPDX-License-Identifier: Apache-2.0
 */

#include "porting_assistant.h"

TEST_STEP(test_step_os_malloc, "Memory allocation")
{
    void *buf = mmosal_malloc(1560);
    if (buf == NULL)
    {
        TEST_LOG_APPEND(
                 "Failed to allocate 1560 bytes. Check that your heap is configured correctly\n\n");
        return TEST_FAILED;
    }
    mmosal_free(buf);
    return TEST_PASSED;
}

TEST_STEP(test_step_os_realloc, "Memory reallocation")
{
    enum constants
    {
        FIRST_ALLOCATION_SIZE = 100,
        REALLOCATION_SIZE     = 200,
    };

    uint8_t *buf = (uint8_t *)mmosal_malloc(FIRST_ALLOCATION_SIZE);
    if (buf == NULL)
    {
        TEST_LOG_APPEND(
                 "Failed to allocate %d bytes. Check that your heap is configured correctly\n\n",
                 FIRST_ALLOCATION_SIZE);
        return TEST_FAILED_NON_CRITICAL;
    }
    memset(buf, 0xc0, FIRST_ALLOCATION_SIZE);

    uint8_t *buf1 = (uint8_t *)mmosal_realloc(buf, REALLOCATION_SIZE);
    if (buf1 == NULL)
    {
        TEST_LOG_APPEND(
                 "Failed to reallocate %d bytes. Check that your heap supports realloc\n\n",
                 REALLOCATION_SIZE);
        return TEST_FAILED_NON_CRITICAL;
    }

    /* Verify the reallocated memory contains the contents of the original block. */
    unsigned ii;
    for (ii = 0; ii < FIRST_ALLOCATION_SIZE; ii++)
    {
        if (buf1[ii] != 0xc0)
        {
            TEST_LOG_APPEND(
                     "Reallocated block contents mismatch at offset %u\n\n", ii);
            return TEST_FAILED_NON_CRITICAL;
        }
    }

    mmosal_free(buf1);
    return TEST_PASSED;
}

TEST_STEP(test_step_os_time, "Passage of time")
{
    uint32_t start_time = mmosal_get_time_ms();
    mmosal_task_sleep(50);
    uint32_t end_time = mmosal_get_time_ms();

    int32_t delta = (int32_t)(end_time - start_time);
    if (delta < 49 || delta > 51)
    {
        TEST_LOG_APPEND(
                 "Time delta (%ld ms) did not match sleep time (50 ms)\n\n", delta);
        return TEST_FAILED;
    }

    return TEST_PASSED;
}

/** Enumeration of task states for the task that is created during the task creation/preemption
 *  test. */
enum task_state
{
    TASK_NOT_STARTED,
    TASK_STARTED,
    TASK_WAITING_FOR_NOTIFICATION,
    TASK_TERMINATING,
    TASK_ERROR_WAITING_FOR_NOTIFICATION,
    TASK_ERROR_GET_ACTIVE_INVALID,
};

/** Current state of the task that is created during the task creation/preemption test. */
static volatile enum task_state task_state = TASK_NOT_STARTED;
/** Handle of the task that is created during the task creation/preemption test. */
static struct mmosal_task * volatile task_handle;

/** Main function of the task that is created during the task creation/preemption test. */
static void new_task_main(void *arg)
{
    (void)arg;

    task_state = TASK_STARTED;

    /* Sleep for 10 ms; this should yield the task. */
    mmosal_task_sleep(10);

    /* Verify mmosal_task_get_active() returns the correct task handle. */
    if (mmosal_task_get_active() != task_handle)
    {
        task_state = TASK_ERROR_GET_ACTIVE_INVALID;
        return;
    }

    /* Wait for notification. */
    task_state = TASK_WAITING_FOR_NOTIFICATION;
    bool ok = mmosal_task_wait_for_notification(UINT32_MAX);
    if (!ok)
    {
        task_state = TASK_ERROR_WAITING_FOR_NOTIFICATION;
        return;
    }

    task_state = TASK_TERMINATING;

    /* Delete self */
    mmosal_task_delete(NULL);
}

TEST_STEP(test_step_os_task_creation, "Task creation and preemption")
{
    task_handle = mmosal_task_create(
        new_task_main, NULL, MMOSAL_TASK_PRI_HIGH, 512, "Test Task");
    if (task_handle == NULL)
    {
        TEST_LOG_APPEND(
                 "mmosal_task_create() returned NULL; expected a task handle.\n\n");
        return TEST_FAILED_NON_CRITICAL;
    }

    /*
     * The newly created task should be higher priority. Therefore the following code should
     * not run until after the task yields.
     */
    if (task_state != TASK_STARTED)
    {
        TEST_LOG_APPEND(
                 "The task created with mmosal_task_create() did not run.\n\n");
        return TEST_FAILED_NON_CRITICAL;
    }

    /* Allow some time for the task to wake up and then wait for notification. */
    mmosal_task_sleep(50);

    switch (task_state)
    {
    case TASK_WAITING_FOR_NOTIFICATION:
        break;

    case TASK_ERROR_GET_ACTIVE_INVALID:
        TEST_LOG_APPEND(
                 "mmosal_task_get_active() did not return the correct task handle.\n\n");
        return TEST_FAILED_NON_CRITICAL;

    case TASK_ERROR_WAITING_FOR_NOTIFICATION:
        TEST_LOG_APPEND(
                 "mmosal_task_wait_for_notification() unexpectedly returned false.\n\n");
        return TEST_FAILED_NON_CRITICAL;

    default:
        TEST_LOG_APPEND(
                 "Task in unexpected state %d.\n\n", task_state);
        return TEST_FAILED_NON_CRITICAL;
    }

    /* Notify the task and ensure that it proceeded to the next state */
    mmosal_task_notify(task_handle);

    switch (task_state)
    {
    case TASK_TERMINATING:
        return TEST_PASSED;

    case TASK_ERROR_GET_ACTIVE_INVALID:
        TEST_LOG_APPEND(
                 "mmosal_task_get_active() did not return the correct task handle.\n\n");
        return TEST_FAILED_NON_CRITICAL;

    case TASK_ERROR_WAITING_FOR_NOTIFICATION:
        TEST_LOG_APPEND(
                 "mmosal_task_wait_for_notification() unexpectedly returned false.\n\n");
        return TEST_FAILED_NON_CRITICAL;

    default:
        TEST_LOG_APPEND(
                 "Task in unexpected state %d.\n\n", task_state);
        return TEST_FAILED_NON_CRITICAL;
    }
}
```

## src/test_wlan_io.c
```c
/*
 * Copyright 2023 Morse Micro
 *
 * SPDX-License-Identifier: Apache-2.0
 */

#include "porting_assistant.h"
#include "sdio_spi.h"
#include "mmhal.h"
#include "mmlog.h"
#include "mmutils.h"
#include "mm6108_reg.h"

/** Address used when measuring raw throughput */
#define MM6108_BENCHMARK_ADDR_START      0x80100000

/** Packet length used for bulk read/write operations. Chosen because it is the approximate size of
 * a max data frame. */
#define BULK_RW_PACKET_LEN_BYTES (1496)

/** Duration to perform the benchmark over. This was arbitrarily chosen. */
#define BENCHMARK_WAIT_MS (2500)


/* MM6108 WLAN GPIO definitions */
#define BUSY_GPIO_MASK (0x00000001)

#define GPIO_NOT_ASSERTED    0
#define GPIO_ASSERTED        1

/** Array of valid chip ids for the MM6108 */
const uint32_t valid_chip_ids[] = {
    0x206,
    0x306,
    0x406,
};

/**
 * Function to validate if a given chip id is valid.
 *
 * @param chip_id Chip ID to validate
 *
 * @return @c true if the given id is in the list of valid ids, else @c false
 */
static bool valid_chip_id(uint32_t chip_id)
{
    int ii;
    int num_valid_chip_ids = sizeof(valid_chip_ids)/sizeof(valid_chip_ids[0]);

    for (ii = 0; ii < num_valid_chip_ids; ii++)
    {
        if (chip_id == valid_chip_ids[ii])
        {
            return true;
        }
    }

    return false;
}

/** This variable is going to be increased with each test interrupt. */
static volatile uint8_t irq_counter = 0;

/**
 * This Function is passed into wlan HAL to be called when busy pin is asserted.
 *
 */
static void test_hal_irq_handle(void)
{
    irq_counter++;
}

TEST_STEP(test_step_mmhal_wlan_init, "WLAN HAL initialisation")
{
    MM_UNUSED(log_buf);
    MM_UNUSED(log_buf_len);

    mmhal_wlan_init();

    /* We don't get indication of success or failure from mmhal_wlan_init() so we return
     * "no result". */
    return TEST_NO_RESULT;
}

TEST_STEP(test_step_mmhal_wlan_hard_reset, "Hard reset device")
{
    MM_UNUSED(log_buf);
    MM_UNUSED(log_buf_len);

    mmhal_wlan_hard_reset();

    /*
     * Since mmhal_wlan_hard_reset() does not return a status code we cannot verify here whether
     * the MM chip was reset successfully at this stage, so we return "no result". To validate
     * reset behavior an external logic analyzer can be used to probe the reset line.
     */
    return TEST_NO_RESULT;
}

TEST_STEP(test_step_mmhal_wlan_sdio_startup, "SDIO/SPI Startup")
{
    int ret;

    MM_UNUSED(log_buf);
    MM_UNUSED(log_buf_len);

    ret = mmhal_wlan_sdio_startup();

    switch (ret)
    {
    case 0:
        return TEST_PASSED;

    case MMHAL_SDIO_HW_ERROR:
        TEST_LOG_APPEND(
            "SDIO/SPI controller hardware error. Possible causes:\n"
            " - SDIO/SPI controller not configured correctly\n"
            " - SDIO/SPI controller clock not enabled\n\n");
        return TEST_FAILED;

    case MMHAL_SDIO_CMD_TIMEOUT:
        TEST_LOG_APPEND(
            "Timeout while executing an SDIO command. Possible causes:\n"
            " - SDIO/SPI pins not set to correct function (e.g., output instead of alternative)\n"
            " - SPI chip select not being asserted\n"
            " - MM chip not powered on\n\n");
        return TEST_FAILED;

    case MMHAL_SDIO_CMD_CRC_ERROR:
        TEST_LOG_APPEND(
            "CRC error in command or response while executing an SDIO command. Possible causes:\n"
            " - Noise on SPI/SDIO lines\n"
            " - Wrong SPI device selected\n\n");
        return TEST_FAILED;

    case MMHAL_SDIO_DATA_TIMEOUT:
        TEST_LOG_APPEND(
            "Timeout while transferring data. Possible causes:\n"
            " - Communication errors due to noise on SPI/SDIO lines\n"
            " - SPI/SDIO clock rate too low\n"
            " - SPI/SDIO data timeout to aggressive\n\n");
        return TEST_FAILED;

    case MMHAL_SDIO_DATA_UNDERFLOW:
        TEST_LOG_APPEND(
            "Data underflow. Possible causes:\n"
            " - DMA incorrectly configured\n"
            " - Data being fed into the SPI/SDIO controller FIFO too slowly\n\n");
        return TEST_FAILED;

    case MMHAL_SDIO_DATA_OVERRUN:
        TEST_LOG_APPEND(
            "Data overrun. Possible causes:\n"
            " - DMA incorrectly configured\n"
            " - Data being read from the SPI/SDIO controller FIFO too slowly\n\n");
        return TEST_FAILED;

    default:
        TEST_LOG_APPEND(
            "An unspecified error occurred. This may be due to communications or other isuses.\n"
            "Possible causes may include:\n"
            " - SDIO/SPI controller not configured correctly\n"
            " - Communication errors due to noise on SPI/SDIO lines\n\n");
        return TEST_FAILED;
    }
}

TEST_STEP(test_step_read_chip_id, "Read chip id from the MM chip")
{
    /*
     * This step is deceptively complicated. Reading the chip id using the SDIO over SPI protocol
     * requires a decent amount of setup. At a high-level the following gets executed:
     *
     * 1. The upper 16bits of the address is set into keyhole registers (relevant for CMD52/53)
     *    - This requires three (3) CMD52 writes to be achieved
     * 2. We execute a CMD53 read
     *    - We first write a CMD53 to the chip indicating that we want to read data and how much.
     *    - We then read out the amount of data requested plus a CRC which is used to validate
     *      the data integrity.
     *
     * This is glossing over the details but what we want to convey here is that sdio_spi_read_le32
     * is not just a read but a series of reads and writes.
     */

    int ret = MMHAL_SDIO_OTHER_ERROR;
    uint32_t data;
    int ii;

    /* MM chip requires few bytes to be written after CMD63 to get it to active state. We just
     * attempt to read the chip id a few times. */
    for (ii = 0; ii < 3; ii++)
    {
        ret = sdio_spi_read_le32(MM6108_REG_CHIP_ID, &data);
        if (ret == 0)
        {
            break;
        }
    }

    switch (ret)
    {
    case 0:
        if (valid_chip_id(data))
        {
            return TEST_PASSED;
        }
        TEST_LOG_APPEND("Failed to read valid chip id, recieved 0x%04lx\n\n", data);
        break;

    case MMHAL_SDIO_CMD_TIMEOUT:
        /* We shouldn't get this error code in this test, since it should have caused the
         * previous test to fail. */
        TEST_LOG_APPEND(
            "Failed to read chip id due to a command timeout. Possible causes:\n"
            " - SPI/SDIO controller not configured correctly\n"
            " - SPI/SDIO pins not set to correct function (e.g., output instead of alternative)\n"
            " - SPI Chip Select not being asserted (should be low during the transfer)\n"
            " - MM chip not powered on\n\n");
        break;

    case MMHAL_SDIO_CMD_CRC_ERROR:
        TEST_LOG_APPEND("Failed to validate CRC for recieved data. Possible causes:\n"
                        " - Error in reading data from SPI/SDIO peripheral\n"
                        " - Possible noise on the SPI/SDIO lines causing corruption\n\n");
        break;

    default:
        TEST_LOG_APPEND("Failed to read chip id due to an unknown error\n\n");
        break;
    }

    return TEST_FAILED;
}

/**
 * Function to process return codes from @ref sdio_spi_write_multi_byte() and @ref
 * sdio_spi_read_multi_byte(). This attempts to give some hints as to what might be the cause of the
 * error.
 *
 * @param ret           Return code to process.
 * @param log_buf       Reference to the log buffer to append any messages.
 * @param log_buf_len   Length of the log buffer.
 *
 * @return @c true if it was a successful return code, else @c false for all other codes.
 */
bool process_sdio_spi_multi_byte_return(int ret, char *log_buf, size_t log_buf_len)
{
    switch (ret)
    {
    case 0:
        return true;
        break;

    case MMHAL_SDIO_CMD_TIMEOUT:
        /* We shouldn't get this error code in this test, since it should have caused the
         * previous test to fail. */
        TEST_LOG_APPEND(
            "Failed to read chip ID due to the timeout. Possible causes:\n"
            " - SPI/SDIO controller not configured correctly\n"
            " - SPI/SDIO pins not set to correct function (e.g., output instead of alternative)\n"
            " - SPI Chip Select not being asserted (should be low during the transfer)\n"
            " - MM chip not powered on\n\n");
        break;

    case MMHAL_SDIO_CMD_CRC_ERROR:
        TEST_LOG_APPEND("Failed to validate CRC for recieved data. Possible causes:\n"
                        " - Error in reading data from SPI peripheral\n"
                        " - Possible noise on the SPI lines causing corruption\n\n");
        break;

    case MMHAL_SDIO_INVALID_ARGUMENT:
        /* We should not reach this. */
        TEST_LOG_APPEND("Invalid input was given to sdio_spi_read_le32().\n"
                        "Likely a NULL pointer for the data variable\n\n");
        break;

    default:
        TEST_LOG_APPEND("Failed multi byte operation due to an unknown error\n\n");
    }

    return TEST_FAILED;
}

/**
 * Function to populate a buffer with a specific pattern.
 *
 * @param data      Reference to the buffer.
 * @param length    Length of the given buffer.
 */
void populate_buffer(uint8_t *data, uint32_t length)
{
    uint32_t cnt;
    for (cnt = 0; cnt < length; cnt++)
    {
        data[cnt] = cnt;
    }
}

/**
 * Function to validate the contents of a buffer matches what would be expected if @ref
 * populate_buffer() was called on it.
 *
 * @param data      Reference to the buffer.
 * @param length    Length of the given buffer.
 *
 * @return @c true if the contents matches the expected patter, else @c false
 */
bool valid_buffer(uint8_t *data, uint32_t length, uint32_t offset)
{
    uint8_t value = offset;
    uint32_t cnt;
    for (cnt = 0; cnt < length; cnt++)
    {
        if (data[cnt] != value++)
        {
            printf("\nInvalid data at %lu (offset=%lu, expect %02x got %02x)\n",
                   cnt, offset, value, data[cnt]);
            return false;
        }
    }
    return true;
}

TEST_STEP(test_step_bulk_write_read, "Bulk write/read into the MM chip")
{
    int ret = MMHAL_SDIO_OTHER_ERROR;
    bool ok;
    enum test_result result = TEST_PASSED;

    uint8_t *tx_data = (uint8_t *)mmosal_malloc(BULK_RW_PACKET_LEN_BYTES);
    uint8_t *rx_data = (uint8_t *)mmosal_malloc(BULK_RW_PACKET_LEN_BYTES);
    if ((tx_data == NULL) || (rx_data == NULL))
    {
        TEST_LOG_APPEND("Failed to allocate write/read buffers. Is there enough heap allocated?");
        result = TEST_FAILED;
        goto exit;
    }

    populate_buffer(tx_data, BULK_RW_PACKET_LEN_BYTES);

    ret = sdio_spi_write_multi_byte(MM6108_BENCHMARK_ADDR_START, tx_data, BULK_RW_PACKET_LEN_BYTES);
    ok = process_sdio_spi_multi_byte_return(ret, log_buf, log_buf_len);
    if (!ok)
    {
        TEST_LOG_APPEND("Failure during sdio_spi_write_multi_byte\n");
        result = TEST_FAILED;
        goto exit;
    }

    ret = sdio_spi_read_multi_byte(MM6108_BENCHMARK_ADDR_START, rx_data, BULK_RW_PACKET_LEN_BYTES);
    ok = process_sdio_spi_multi_byte_return(ret, log_buf, log_buf_len);
    if (!ok)
    {
        TEST_LOG_APPEND("Failure during sdio_spi_read_multi_byte\n");
        result = TEST_FAILED;
        goto exit;
    }

    if (!valid_buffer(rx_data, BULK_RW_PACKET_LEN_BYTES, 0))
    {
        TEST_LOG_APPEND("Data read from the MM chip does not match the data written.\n");
        result = TEST_FAILED;
        goto exit;
    }

exit:
    if (tx_data != NULL)
    {
        mmosal_free(tx_data);
    }

    if (rx_data != NULL)
    {
        mmosal_free(rx_data);
    }

    return result;
}


TEST_STEP(test_step_raw_tput, "Raw throughput test")
{
    /*
     * Please note that this test is intended to give some indication of the raw throughput that can
     * be achieved when transferring data across the bus to/from the MM chip. It serves more as an
     * upper limit for the WLAN throughput that can be achieved. The actual throughput that can be
     * achieved when transmitting will be lower than this. This is because there are additional
     * overheads that are not captured as part of this test.
     */
    int ret = MMHAL_SDIO_OTHER_ERROR;
    bool ok;
    enum test_result result = TEST_PASSED;
    unsigned offset = 0;
    uint32_t start_time;
    uint32_t end_time;
    uint32_t time_taken_ms;
    uint32_t benchmark_end_time;
    uint32_t transaction_count = 0;

    uint8_t *tx_data = (uint8_t *)mmosal_malloc(BULK_RW_PACKET_LEN_BYTES + 16);
    uint8_t *rx_data = (uint8_t *)mmosal_malloc(BULK_RW_PACKET_LEN_BYTES);
    if ((tx_data == NULL) || (rx_data == NULL))
    {
        TEST_LOG_APPEND("Failed to allocate write/read buffers. Is there enough heap allocated?");
        result = TEST_FAILED;
        goto exit;
    }

    populate_buffer(tx_data, BULK_RW_PACKET_LEN_BYTES + 16);

    start_time = mmosal_get_time_ms();
    benchmark_end_time = start_time + BENCHMARK_WAIT_MS;
    while (mmosal_time_le(mmosal_get_time_ms(), benchmark_end_time))
    {
        offset += 4;
        ret = sdio_spi_write_multi_byte(MM6108_BENCHMARK_ADDR_START, tx_data + (offset & 15),
                                        BULK_RW_PACKET_LEN_BYTES);
        ok = process_sdio_spi_multi_byte_return(ret, log_buf, log_buf_len);
        if (!ok)
        {
            TEST_LOG_APPEND("Failure during sdio_spi_write_multi_byte\n");
            result = TEST_FAILED;
            goto exit;
        }

        ret = sdio_spi_read_multi_byte(MM6108_BENCHMARK_ADDR_START, rx_data,
                                       BULK_RW_PACKET_LEN_BYTES);
        ok = process_sdio_spi_multi_byte_return(ret, log_buf, log_buf_len);
        if (!ok)
        {
            TEST_LOG_APPEND("Failure during sdio_spi_read_multi_byte\n");
            result = TEST_FAILED;
            goto exit;
        }

        transaction_count++;
    }
    end_time = mmosal_get_time_ms();

    /* We are only validating the contents of the buffer once because there are already checks in
     * place at the transport layer to validate the contents. This is in the form of CRCs. We just
     * perform this check for sanity's sake. */
    if (!valid_buffer(rx_data, BULK_RW_PACKET_LEN_BYTES, offset & 15))
    {
        TEST_LOG_APPEND("Data read from the MM chip does not match the data written.\n");
        result = TEST_FAILED;
        goto exit;
    }

    time_taken_ms = end_time - start_time;
    TEST_LOG_APPEND("Note: This will not be the final WLAN TPUT. See test step for more info.\n");
    TEST_LOG_APPEND("\tTime spent (ms):   %lu\n", time_taken_ms);
    TEST_LOG_APPEND("\tTransaction count: %lu\n", transaction_count);
    TEST_LOG_APPEND("\tBytes xferred:     %lu\n", transaction_count * 2 * BULK_RW_PACKET_LEN_BYTES);
    TEST_LOG_APPEND("\tRaw TPUT (kbit/s): %lu\n\n",
                    (transaction_count * 2 * BULK_RW_PACKET_LEN_BYTES * 8) / time_taken_ms);

exit:
    if (tx_data != NULL)
    {
        mmosal_free(tx_data);
    }

    if (rx_data != NULL)
    {
        mmosal_free(rx_data);
    }

    return result;
}

TEST_STEP(test_step_verify_busy_pin, "Verify BUSY pin")
{
    /* In this We toggle the BUSY pin from MM6108 and expect that we can see the
     * input change and the busy irq handler gets called. */
    enum test_result result = TEST_PASSED;
    uint32_t out_en_backup = 0;
    uint8_t i = 0;
    irq_counter = 0;
    if (sdio_spi_read_le32(MM6108_REG_OUT_EN, &out_en_backup) != 0)
    {
        TEST_LOG_APPEND("Unable to Read MM6108_REG_OUT_EN\n");
        return TEST_FAILED;
    }
    sdio_spi_set_bits_le32(MM6108_REG_OUT_EN, BUSY_GPIO_MASK);
    sdio_spi_clear_bits_le32(MM6108_REG_OUT_VAL, BUSY_GPIO_MASK);
    mmhal_wlan_register_busy_irq_handler(test_hal_irq_handle);

    /* First toggle pin with IRQ enabled to verify the input value and irq handle call. */
    mmhal_wlan_set_busy_irq_enabled(true);
    for (i = 0; i < 2; i++)
    {
        sdio_spi_set_bits_le32(MM6108_REG_OUT_VAL, BUSY_GPIO_MASK);
        mmosal_task_sleep(2);
        if (!mmhal_wlan_busy_is_asserted())
        {
            TEST_LOG_APPEND("BUSY pin set HIGH but mmhal_wlan_busy_is_asserted() returned false "
                            "(expected true)\n\n");
            result = TEST_FAILED;
            goto exit;
        }
        sdio_spi_clear_bits_le32(MM6108_REG_OUT_VAL, BUSY_GPIO_MASK);
        mmosal_task_sleep(2);
        if (mmhal_wlan_busy_is_asserted())
        {
            TEST_LOG_APPEND("BUSY pin is set LOW but mmhal_wlan_busy_is_asserted() returned true "
                            "(expected false)\n\n");
            result = TEST_FAILED;
            goto exit;
        }
    }
    if (irq_counter != 2)
    {
        TEST_LOG_APPEND("BUSY ping IRQ hander was not called as expected. Expected 2 invocations, "
                        "but was invoked %u times\n\n",
                        irq_counter);
        result = TEST_FAILED;
        goto exit;
    }
    /* Now toggle the pin with IRQ disabled and make sure handler isn't called. */
    mmhal_wlan_set_busy_irq_enabled(false);
    for (i = 0; i < 2; i++)
    {
        sdio_spi_set_bits_le32(MM6108_REG_OUT_VAL, BUSY_GPIO_MASK);
        mmosal_task_sleep(2);
        sdio_spi_clear_bits_le32(MM6108_REG_OUT_VAL, BUSY_GPIO_MASK);
        mmosal_task_sleep(2);
    }
    if (irq_counter > 2)
    {
      TEST_LOG_APPEND("Busy IRQ is still enabled.\n\n");
      result = TEST_FAILED;
      goto exit;
    }

exit:
    mmhal_wlan_set_busy_irq_enabled(false);
    mmhal_wlan_register_busy_irq_handler(NULL);
    sdio_spi_write_multi_byte(MM6108_REG_OUT_EN, (uint8_t *)&out_en_backup,
                              sizeof(out_en_backup));
    irq_counter = 0;
    return result;
}
```
