## dts/bindings/wifi/morsemicro,sm-sd.yaml
```yaml
# Copyright 2026 Morse Micro
# SPDX-License-Identifier: Apache-2.0

description: Morse Micro Wi-Fi HaLow SoftMAC peripheral on a SDIO bus

include:
  - morsemicro,sm.yaml
  - sd-device.yaml
```

## dts/bindings/wifi/morsemicro,sm-spi.yaml
```yaml
# Copyright 2024-2026 Morse Micro
# SPDX-License-Identifier: Apache-2.0

description: Morse Micro Wi-Fi HaLow SoftMAC peripheral on a SPI bus

include:
  - morsemicro,sm.yaml
  - spi-device.yaml

properties:

  spi-irq-gpios:
    type: phandle-array
    required: true
    description: Additional IRQ line for the SPI bus.
```

## dts/bindings/wifi/morsemicro,sm.yaml
```yaml
# Copyright 2026 Morse Micro
# SPDX-License-Identifier: Apache-2.0

description: Morse Micro Wi-Fi HaLow SoftMAC peripheral

properties:

  bcf:
    type: string
    required: true
    description: String representing the name of a BCF in mm-iot-sdk/framework/morsefirmware

  resetn-gpios:
    type: phandle-array
    required: true
    description: Logic low pin for resetting the chip.

  wakeup-gpios:
    type: phandle-array
    description: |
      Line for communicating when the host has data for the chip.

      Required for power saving features.

      The wake line needs to be driven high by either the driver by defining these, attaching a
      gpio-hog to the relevant pin, or at the hardware level freeing up a host gpio.

      Defining this without busy-gpios intentionally throws build errors. Use a gpio-hog instead
      if busy is not implemented.


  busy-gpios:
    type: phandle-array
    description: |
      Line for communicating when chip has data for the host.

      Required for power saving features.

      Defining this without wakeup-gpios intentionally throws build errors. If wakeup is hardware
      driven, or driven by a gpio hog, this can be safely left undefined to indicate that there is
      not a configuration issue.
```

## samples/halow_zperf/sample.yaml
```yaml
tests:
  halow_zperf.run:
    platform_allow:
      - mm6108_ekh05
      - mm8108_ekh05
    build_only: true
    integration_platforms:
      - mm6108_ekh05
      - mm8108_ekh05
    tags:
      - build-only

  halow_zperf.run.shield.mmech08.nucleo_u575zi_q:
    platform_allow:
      - nucleo_u575zi_q
    build_only: true
    build_on_all: true
    extra_args: SHIELD=morsemicro_mmech08
    tags:
      - shield
      - build-only

  halow_zperf.run.shield.mmech08.nucleo_h753zi:
    platform_allow:
      - nucleo_h753zi
    build_only: true
    extra_args: SHIELD=morsemicro_mmech08
    tags:
      - shield
      - build-only

  halow_zperf.run.shield.mmech08.ek_ra6m5:
    platform_allow:
      - ek_ra6m5
    build_only: true
    extra_args: SHIELD=morsemicro_mmech08
    tags:
      - shield
      - build-only

  halow_zperf.run.shield.mmech18.nucleo_u575zi_q:
    platform_allow:
      - nucleo_u575zi_q
    build_only: true
    extra_args: SHIELD=morsemicro_mmech18
    tags:
      - shield
      - build-only

  halow_zperf.run.shield.mmech18.nucleo_h753zi:
    platform_allow:
      - nucleo_h753zi
    build_only: true
    extra_args: SHIELD=morsemicro_mmech18
    tags:
      - shield
      - build-only

  halow_zperf.run.shield.mmech18.ek_ra6m5:
    platform_allow:
      - ek_ra6m5
    build_only: true
    extra_args: SHIELD=morsemicro_mmech18
    tags:
      - shield
      - build-only
```

## tests/ap_channel_regdb/testcase.yaml
```yaml
# Copyright 2026 Morse Micro
# SPDX-License-Identifier: Apache-2.0

common:
  tags:
    - drivers
    - wifi
    - morsemicro

tests:
  drivers.wifi.morsemicro.ap_channel_regdb: {}
```

## tests/mbin_cascade/testcase.yaml
```yaml
# Copyright 2026 Morse Micro
# SPDX-License-Identifier: Apache-2.0

common:
  filter: dt_compat_enabled("morsemicro,mm6108") or
          dt_compat_enabled("morsemicro,mm8108")
  extra_args:
    - CONF_FILE=${ZEPHYR_MORSEMICRO_MODULE_DIR}/tests/prj.conf

tests:
  net.wifi.halow.pytest.mbin.direct:
    build_only: true
    harness: pytest
    platform_allow:
      - mm8108_ekh05
    extra_configs:
      - CONFIG_WIFI_MORSEMICRO_REGION="ZZ"
    tags:
      - wifi
      - net
      - halow

  net.wifi.halow.pytest.mbin.local:
    build_only: true
    harness: pytest
    platform_allow:
      - nucleo_u575zi_q
    extra_args:
      - CONFIG_WIFI_MORSEMICRO_REGION="ZZ"
      - SHIELD="morsemicro_mmech18"
```
