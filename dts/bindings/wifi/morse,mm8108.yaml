## dts/bindings/wifi/morse,mm8108.yaml
```yaml
# Copyright 2025 Morse Micro
# SPDX-License-Identifier: Apache-2.0

description: Morse Micro MM8108 module

compatible: "morse,mm8108"

include: morse,spi.yaml
```

## dts/bindings/wifi/morse,spi.yaml
```yaml
# Copyright 2024-2025 Morse Micro
# SPDX-License-Identifier: Apache-2.0

include: spi-device.yaml

properties:
  resetn-gpios:
    type: phandle-array
    required: true

  busy-gpios:
    type: phandle-array

  wakeup-gpios:
    type: phandle-array

  spi-irq-gpios:
    type: phandle-array
    required: true
```

## samples/halow_client/sample.yaml
```yaml
tests:
  halow_client.build:
    platform_allow:
      - mm6108_ekh05_v3
      - mm8108_ekh05
    build_only: true
    build_on_all: true
    tags:
      - build
  halow_client.build.shield:
    platform_allow:
      - nucleo_u575zi_q
    build_only: true
    build_on_all: true
    extra_args: SHIELD=morse_mmech08
    tags:
      - shield
      - build
```
