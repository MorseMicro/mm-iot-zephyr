## boards/morsemicro/m2m_u575/Kconfig.m2m_u575
```kconfig
# Copyright (c) 2021 Linaro Limited
# Copyright (c) 2025 Morse Micro
# SPDX-License-Identifier: Apache-2.0

config BOARD_M2M_U575
	select SOC_STM32U575XX
```

## boards/morsemicro/mm6108_ekh05_v3/Kconfig.defconfig
```kconfig
# Morse Micro MM6108 EKH05 V3 Evaluation Kit

# Copyright 2025 Morse Micro
# SPDX-License-Identifier: Apache-2.0

if BOARD_MM6108_EKH05_V3


config SPI
	default y

if BT
config BT_SPI
	default y

config BT_BLUENRG_ACI
	default y

# Disable Flow control
config BT_HCI_ACL_FLOW_CONTROL
	default n

endif # BT

config SPI_STM32_INTERRUPT
	default y
	depends on SPI

config SPI_STM32_DMA
	# Enable DMA for SPI
	default y
	depends on SPI

config SPI_STM32_OPTIM
	# Enable Optimised SPI driver
	default y
	depends on SPI

DT_CHOSEN_ZEPHYR_CONSOLE := zephyr,console

config UART_CONSOLE
	default y if $(dt_chosen_enabled,$(DT_CHOSEN_ZEPHYR_CONSOLE)) && CONSOLE

config WIFI_MORSE_SM
	default y
	select WIFI
	select NETWORKING


endif # BOARD_MM6108_EKH05_V3
```

## boards/morsemicro/mm6108_ekh05_v3/Kconfig.mm6108_ekh05_v3
```kconfig
# Copyright 2025 Morse Micro
# SPDX-License-Identifier: Apache-2.0

config BOARD_MM6108_EKH05_V3
	select SOC_STM32U585XX
```

## boards/morsemicro/mm6108_ekh05_v3/mm6108_ekh05_v3_pm_defconfig
```kconfig
# SPDX-License-Identifier: Apache-2.0

# Enable MPU
CONFIG_ARM_MPU=y

# Enable hardware stack protection
CONFIG_HW_STACK_PROTECTION=y

# enable GPIO
CONFIG_GPIO=y
CONFIG_GPIO_HOGS=y

# Enable Clocks
CONFIG_CLOCK_CONTROL=y

CONFIG_PM=y
CONFIG_PM_DEVICE=y

CONFIG_DEBUG=n

CONFIG_SERIAL=n
CONFIG_UART_CONSOLE=n
CONFIG_LOG=n
CONFIG_NET_LOG=n

# enable pin controller
CONFIG_PINCTRL=y

CONFIG_WIFI_MORSE_BCF="bcf_aw_hm593.mbin"
```

## boards/morsemicro/mm8108_ekh05/Kconfig.defconfig
```kconfig
# Morse Micro MM8108 EKH05 Evaluation Kit

# Copyright 2025 Morse Micro
# SPDX-License-Identifier: Apache-2.0

if BOARD_MM8108_EKH05

if BT

config SPI
	default y

config BT_SPI
	default y

config BT_BLUENRG_ACI
	default y

# Disable Flow control
config BT_HCI_ACL_FLOW_CONTROL
	default n

endif # BT

config SPI_STM32_INTERRUPT
	default y
	depends on SPI

DT_CHOSEN_ZEPHYR_CONSOLE := zephyr,console

config UART_CONSOLE
	default y if $(dt_chosen_enabled,$(DT_CHOSEN_ZEPHYR_CONSOLE)) && CONSOLE

config WIFI_MORSE
	default y
	select WIFI
	select NETWORKING


endif # BOARD_MM8108_EKH05
```

## boards/morsemicro/mm8108_ekh05/Kconfig.mm8108_ekh05
```kconfig
# Copyright 2025 Morse Micro
# SPDX-License-Identifier: Apache-2.0

config BOARD_MM8108_EKH05
	select SOC_STM32U585XX
```

## boards/shields/morse_mmech08/Kconfig.defconfig
```kconfig
# Copyright 2025 Morse Micro
# SPDX-License-Identifier: Apache-2.0

config WIFI_MORSE_SM
	default y if SHIELD_MORSE_MMECH08
```

## boards/shields/morse_mmech08/Kconfig.shield
```kconfig
# Copyright 2024 Morse Micro
# SPDX-License-Identifier: Apache-2.0

config SHIELD_MORSE_MMECH08
	def_bool $(shields_list_contains,morse_mmech08)
```

## boards/shields/morse_mmech18/Kconfig.defconfig
```kconfig
# Copyright 2025 Morse Micro
# SPDX-License-Identifier: Apache-2.0

config WIFI_MORSE
	default y if SHIELD_MORSE_MMECH18

config WIFI_MORSE_BCF
	default "bcf_mf15457.mbin" if SHIELD_MORSE_MMECH18
```

## boards/shields/morse_mmech18/Kconfig.shield
```kconfig
# Copyright 2025 Morse Micro
# SPDX-License-Identifier: Apache-2.0

config SHIELD_MORSE_MMECH18
	def_bool $(shields_list_contains,morse_mmech18)
```

## boards/shields/morse_mmech18/boards/ek_ra6m5.conf
```kconfig
#
# Copyright 2025 Morse Micro
#
# SPDX-License-Identifier: Apache-2.0
#
CONFIG_THREAD_STACK_INFO=y
CONFIG_SPI_INTERRUPT=y
CONFIG_SPI_RA_DTC=y
```

## boards/shields/morse_mmech18/boards/nrf5340dk_nrf5340_cpuapp.conf
```kconfig
#
# Copyright 2025 Morse Micro
#
# SPDX-License-Identifier: Apache-2.0
#

# Experimenting with the nrf5340 on the cpuapp core for now.
# This has some limitations in entropy (typically requiring)
# an RPC to the network core for RNG.
# Enable test entropy to verify build
CONFIG_TEST_RANDOM_GENERATOR=y
```

## components/morse_sm/firmware/Kconfig
```kconfig
# Copyright 2026 Morse Micro
# SPDX-License-Identifier: Apache-2.0

menu "Firmware"

config WIFI_MORSE_BCF
	string "Board Configuration File"
	default "bcf_mf08651_us.mbin"
	help
	  Specifies the filename for the bcf. This file must be present
	  in the MM-IoT-SDK firmware directory: submodules/mm-iot-sdk/framework/morsefirmware/{MM_CHIP}/bcf

endmenu
```

## components/morse_sm/hostap/Kconfig
```kconfig
# Copyright 2026 Morse Micro
# SPDX-License-Identifier: Apache-2.0

config MBEDTLS
	bool
	default y

config CUSTOM_MBEDTLS_CFG_FILE
	default y

config MBEDTLS_CFG_FILE
	default "morse_mbedtls_config.h"

config MBEDTLS_ZEPHYR_ENTROPY
	default y
```

## components/morse_sm/mmpktmem/Kconfig
```kconfig
# Copyright 2026 Morse Micro
# SPDX-License-Identifier: Apache-2.0

menu "Packet Memory Configuration"
	config MMPKTMEM_TX_POOL_N_BLOCKS
		int "TX queue blocks"
		default 32
		help
			Number of blocks allocated for the transmit queue

	config MMPKTMEM_RX_POOL_N_BLOCKS
		int "RX queue blocks"
		default 32
		help
			Number of blocks allocated for the receive queue
endmenu
```

## components/morse_sm/regdb/Kconfig
```kconfig
# Copyright 2026 Morse Micro
# SPDX-License-Identifier: Apache-2.0

menu "Regulatory Database"

config WIFI_MORSE_REGION
	string "Device regulatory domain"
	default "AU"
	help
	  Specifies the regulatory domain for which to operate the device.
	  Must be one of AU, EU, IN, JP, KR, NZ, SG, US.

choice WIFI_MORSE_AU_CHANNELISATION
	prompt "Australian channelisation configuration"
	default WIFI_MORSE_AU_CHANNELISATION_REVMF
	help
		Australia's channelisation rules for 802.11ah changed in the 2024
		version of the 802.11 standard. Additionally, there is a proposal for
		2028 which includes better positioned 8 MHz channels.

	config WIFI_MORSE_AU_CHANNELISATION_2020
		bool "802.11-2020"
	config WIFI_MORSE_AU_CHANNELISATION_2024
		bool "802.11-2024"
	config WIFI_MORSE_AU_CHANNELISATION_REVMF
		bool "802.11-revmf"
endchoice

endmenu
```

## drivers/spi/Kconfig.stm32-optim
```kconfig
# Copyright 2025 Morse Micro
# SPDX-License-Identifier: Apache-2.0
menuconfig SPI_STM32_OPTIM
	bool "Optimised STM32 SPI driver"
	default y
	help
	  Enables the optimised STM32 SPI driver.
```

## drivers/wifi/morse/Kconfig.morse
```kconfig
# Copyright 2024 Morse Micro
# SPDX-License-Identifier: Apache-2.0

menuconfig WIFI_MORSE
	bool "MorseMicro HaLow WiFi support"
	default y
	select FPU if CPU_CORTEX_M33 || CPU_CORTEX_M7

if WIFI_MORSE

choice WIFI_MORSE_BUS
	bool "Select BUS interface"
	default WIFI_MORSE_BUS_SPI

config WIFI_MORSE_BUS_SPI
	bool "SPI Bus interface"
	select SPI

endchoice

config WIFI_MORSE_REGION
	string "Device regulatory domain"
	default "AU"
	help
	  Specifies the regulatory domain for which to operate the device.
	  Must be one of AU, EU, IN, JP, KR, NZ, SG, US.

choice WIFI_MORSE_BCF
	bool "Board Calibration File"
	default WIFI_MORSE_BCF_MF08651_US

config WIFI_MORSE_BCF_MF08651_US
	bool "MF08651-US"

config WIFI_MORSE_BCF_MF08551
	bool "MF08551"

config WIFI_MORSE_BCF_MF08251
	bool "MF08251"

endchoice

menu "Morse Micro Packet Memory Configuration"
	config MMPKTMEM_TX_POOL_N_BLOCKS
		int "TX queue blocks"
		default 20
		help
			Number of blocks allocated for the transmit queue

	config MMPKTMEM_RX_POOL_N_BLOCKS
		int "RX queue blocks"
		default 23
		help
			Number of blocks allocated for the receive queue
endmenu

config WIFI_MORSE_TEST
	bool "Morse Micro device test driver"
	help
	  Disable registration of network interface to allow testing.
	  To allow testing of the Morse Micro driver HAL layears, and verifying
	  the hardware configuration, this configuration will disable the
	  registration of the Morse Micro device as a Zephyr network interface.

endif
```

## drivers/wifi/morse_fs/Kconfig.morse_fs
```kconfig
menu "Network Drivers / Morse FS Offload"

config WIFI_MORSE_FS
	bool "Morse FS Network Offload Driver"
	select NETWORKING
	select NET_OFFLOAD
	select THREAD_STACK_INFO
	select DYNAMIC_THREAD
	select DYNAMIC_THREAD_ALLOC
	select THREAD_CUSTOM_DATA
	select REBOOT
	select NET_L2_WIFI_MGMT
	select NET_L2_ETHERNET
	select GPIO_GET_CONFIG
	select HWINFO
	select CRC
	select NET_SOCKETS
	select NET_OFFLOAD
	select NET_IPV4
	select NET_TCP
	select WIFI
	select WIFI_OFFLOAD
	select NET_SOCKETS_OFFLOAD
	select NET_MGMT

	depends on !WIFI_MORSE_SM
    help
      Enable FS networking offload via the Morse FS hardware/firmware.

	depends on DT_HAS_MORSEMICRO_FS_ENABLED

endmenu

config HEAP_MEM_POOL_SIZE
	int
	default 16384

config MAIN_STACK_SIZE
	int
	default 4096

config NET_MGMT_EVENT_QUEUE_SIZE
	int
	default 10
```

## drivers/wifi/morse_sm/Kconfig.morse_sm
```kconfig
# Copyright 2024 Morse Micro
# SPDX-License-Identifier: Apache-2.0

menuconfig WIFI_MORSE_SM
	bool "MorseMicro HaLow WiFi support"
	default n
	depends on DT_HAS_MORSE_MM6108_ENABLED \
		|| DT_HAS_MORSE_MM8108_ENABLED
	select DYNAMIC_THREAD
	select REBOOT
	select THREAD_CUSTOM_DATA
	select WIFI_USE_NATIVE_NETWORKING
	select NET_L2_WIFI_MGMT
	select NET_L2_ETHERNET
	select DYNAMIC_THREAD_ALLOC
	select GPIO_GET_CONFIG
	select HWINFO
	select CRC
	select FPU if CPU_CORTEX_M33 || CPU_CORTEX_M7
	select THREAD_ABORT_HOOK

if WIFI_MORSE_SM

menu "Components"
	rsource "../../../components/morse_sm/firmware/Kconfig"
	rsource "../../../components/morse_sm/regdb/Kconfig"
	rsource "../../../components/morse_sm/mmpktmem/Kconfig"
	rsource "../../../components/morse_sm/hostap/Kconfig"
endmenu

choice WIFI_MORSE_BUS
	bool "Select BUS interface"
	default WIFI_MORSE_BUS_SPI

config WIFI_MORSE_BUS_SPI
	bool "SPI Bus interface"
	select SPI

endchoice

config WIFI_MORSE_TEST
	bool "Morse Micro device test driver"
	help
	  Disable registration of network interface to allow testing.
	  To allow testing of the Morse Micro driver HAL layears, and verifying
	  the hardware configuration, this configuration will disable the
	  registration of the Morse Micro device as a Zephyr network interface.

config WIFI_MORSE_EXT_XTAL_INIT
	bool "Enable external crystal initialisation"
	default n
	depends on DT_HAS_MORSE_MM6108_ENABLED
	help
	 For modules which drive the MM6108 with an external crystal, extra
	 initialisation is required. This configuration implements the necessary
	 hook to support this initialisation.

config HEAP_MEM_POOL_ADD_SIZE_MORSE
	int
	default 65536

config NET_MGMT_EVENT_STACK_SIZE
	int
	default 2048

endif
```

## dts/bindings/spi/st,stm32-spi-optim.yaml
```yaml
# Copyright (c) 2018, I-SENSE group of ICCS
# Copyright 2025 Morse Micro
# SPDX-License-Identifier: Apache-2.0

description: STM32 SPI controller

compatible: "st,stm32-spi-optim"

include: st,stm32-spi-common.yaml
```

## dts/bindings/wifi/morse,fs.yaml
```yaml
# SPDX-License-Identifier: Apache-2.0
# morse,fs.yaml
description: Morse FS controllers
compatible: "morse,fs"

include: spi-device.yaml
properties:
  wake-gpios:
    type: phandle-array
    required: true
  irq-gpios:
    type: phandle-array
    required: true
```

## dts/bindings/wifi/morse,mm6108.yaml
```yaml
# Copyright 2024-2025 Morse Micro
# SPDX-License-Identifier: Apache-2.0

description: Morse Micro MM6108 module

compatible: "morse,mm6108"

include: morse,spi.yaml
```
