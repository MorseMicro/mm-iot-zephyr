/*
 * Copyright 2025-2026 Morse Micro
 *
 * SPDX-License-Identifier: Apache-2.0
 */

/dts-v1/;
#include "mm6108_ekh05_common.dtsi"

&sdmmc2 {
	status = "okay";
	compatible = "st,stm32-sdio";
	pinctrl-0 = <&sdmmc2_cmd_pd7 &sdmmc2_ck_pd6
		     &sdmmc2_d0_pb14 &sdmmc2_d1_pb15
		     &sdmmc2_d2_pb3 &sdmmc2_d3_pb4>;
	pinctrl-names = "default";
	bus-width = <4>;
	max-bus-freq = <DT_FREQ_M(50)>;
	interrupt-names = "event";

	morsemicro_wifi_sdio: wifi {
		status = "okay";
		compatible = "morsemicro,mm6108";

		bcf = "bcf_aw_hm593.mbin";
		busy-gpios = <&gpiob 5 GPIO_ACTIVE_HIGH>;
		wakeup-gpios = <&gpiod 0 GPIO_ACTIVE_HIGH>;
		resetn-gpios = <&gpioe 0 GPIO_ACTIVE_LOW>;
	};
};
