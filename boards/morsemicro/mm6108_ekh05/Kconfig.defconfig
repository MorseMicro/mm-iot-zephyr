## boards/morsemicro/mm6108_ekh05/Kconfig.defconfig
```kconfig
# Morse Micro MM6108-EKH05 Evaluation Kit

# Copyright 2025-2026 Morse Micro
# SPDX-License-Identifier: Apache-2.0

if BOARD_MM6108_EKH05


config SPI
	default y

if BT
config BT_SPI
	default y

config BT_BLUENRG_ACI
	default y

# Disable Flow control
config BT_HCI_ACL_FLOW_CONTROL
	default n

endif # BT

config SPI_STM32_INTERRUPT
	default y
	depends on SPI

config SPI_STM32_DMA
	# Enable DMA for SPI
	default y
	depends on SPI

DT_CHOSEN_ZEPHYR_CONSOLE := zephyr,console

config UART_CONSOLE
	default y if $(dt_chosen_enabled,$(DT_CHOSEN_ZEPHYR_CONSOLE)) && CONSOLE

endif # BOARD_MM6108_EKH05
```

## boards/morsemicro/mm6108_ekh05/Kconfig.mm6108_ekh05
```kconfig
# Copyright 2025 Morse Micro
# SPDX-License-Identifier: Apache-2.0

config BOARD_MM6108_EKH05
	select SOC_STM32U585XX if BOARD_REVISION_V3

if BOARD_MM6108_EKH05
	config BOARD_REVISION_V3
		bool
endif
```

## boards/morsemicro/mm6108_ekh05/board.yml
```yaml
board:
  name: mm6108_ekh05
  full_name: Morse Micro MM6108-EKH05
  vendor: morsemicro
  revision:
    format: custom
    default: "v3"
    revisions:
      - name: "v3"
  socs:
    - name: stm32u585xx
      variants:
        - name: 'pm'
```

## boards/morsemicro/mm6108_ekh05/mm6108_ekh05_sdio_pm_defconfig
```kconfig
# SPDX-License-Identifier: Apache-2.0

CONFIG_ARM_MPU=y

CONFIG_HW_STACK_PROTECTION=y

CONFIG_GPIO=y
CONFIG_GPIO_HOGS=y

CONFIG_CLOCK_CONTROL=y
CONFIG_RESET=y

CONFIG_PM=y
CONFIG_PM_DEVICE=y

CONFIG_DEBUG=n

CONFIG_SERIAL=n
CONFIG_UART_CONSOLE=n
CONFIG_LOG=n
CONFIG_NET_LOG=n

CONFIG_PINCTRL=y
```

## boards/morsemicro/mm6108_ekh05_v3/board.yml
```yaml
board:
  name: mm6108_ekh05_v3
  full_name: Morse Micro 6108 EKH 05 V3
  vendor: morsemicro
  socs:
    - name: stm32u585xx
      variants:
        - name: 'pm'
```

## boards/morsemicro/mm8108_ekh05/board.yml
```yaml
board:
  name: mm8108_ekh05
  full_name: Morse Micro MM8108-EKH05
  vendor: morsemicro
  socs:
    - name: stm32u585xx
      variants:
        - name: 'pm'
```

## boards/morsemicro/mmecs03/Kconfig.defconfig
```kconfig
# Morse Micro MMECS03 Evaluation Board

# Copyright 2026 Morse Micro
# SPDX-License-Identifier: Apache-2.0

if BOARD_MMECS03

config SPI
	default y

config SPI_STM32_INTERRUPT
	default y
	depends on SPI

config SPI_STM32_DMA
	# Enable DMA for SPI
	default y
	depends on SPI

DT_CHOSEN_ZEPHYR_CONSOLE := zephyr,console

config UART_CONSOLE
	default y if $(dt_chosen_enabled,$(DT_CHOSEN_ZEPHYR_CONSOLE)) && CONSOLE

endif # BOARD_MMECS03
```

## boards/morsemicro/mmecs03/Kconfig.mmecs03
```kconfig
# Copyright 2026 Morse Micro
# SPDX-License-Identifier: Apache-2.0

config BOARD_MMECS03
	select SOC_STM32U585XX
```

## boards/morsemicro/mmecs03/board.yml
```yaml
board:
  name: mmecs03
  full_name: Morse Micro MMECS03 Demonstration Board
  vendor: morsemicro
  socs:
    - name: stm32u585xx
```

## boards/morsemicro/mmecs03/mmecs03_defconfig
```kconfig
# SPDX-License-Identifier: Apache-2.0

CONFIG_ARM_MPU=y

CONFIG_HW_STACK_PROTECTION=y

CONFIG_GPIO=y
CONFIG_GPIO_HOGS=y

CONFIG_CLOCK_CONTROL=y
CONFIG_RESET=y

CONFIG_SERIAL=y
CONFIG_CONSOLE=y

CONFIG_PINCTRL=y
```

## boards/shields/morsemicro_mmech08/Kconfig.shield
```kconfig
# Copyright 2024-2026 Morse Micro
# SPDX-License-Identifier: Apache-2.0

config SHIELD_MORSEMICRO_MMECH08
	def_bool $(shields_list_contains,morsemicro_mmech08)
```

## boards/shields/morsemicro_mmech18/Kconfig.shield
```kconfig
# Copyright 2025-2026 Morse Micro
# SPDX-License-Identifier: Apache-2.0

config SHIELD_MORSEMICRO_MMECH18
	def_bool $(shields_list_contains,morsemicro_mmech18)
```

## boards/shields/xiao_fgh100mhaamd/Kconfig.shield
```kconfig
# Copyright 2026 Morse Micro
# SPDX-License-Identifier: Apache-2.0

config SHIELD_MORSEMICRO_XIAO_FGH100MHAAMD
	def_bool $(shields_list_contains,xiao_fgh100mhaamd)
```

## boards/shields/xiao_fgh100mhaamd/boards/xiao_esp32c3.conf
```kconfig
#
# Copyright 2026 Morse Micro
#
# SPDX-License-Identifier: Apache-2.0
#

CONFIG_PICOLIBC_USE_MODULE=y
```

## boards/shields/xiao_fgh100mhaamd/boards/xiao_esp32c6_esp32c6_hpcore.conf
```kconfig
#
# Copyright 2026 Morse Micro
#
# SPDX-License-Identifier: Apache-2.0
#

CONFIG_NET_IF_MAX_IPV4_COUNT=2
```

## components/morsemicro/regdb/Kconfig
```kconfig
# Copyright 2026 Morse Micro
# SPDX-License-Identifier: Apache-2.0

menu "Regulatory Database"

config WIFI_MORSEMICRO_REGION
	string "Device regulatory domain"
	default "00"
	help
	  Specifies the regulatory domain for which to operate the device.
	  Defaults to 00, which then requires the application calls wifi_mgmt_regdomain
	  with a region that is supported by the BCF

choice WIFI_MORSEMICRO_AU_CHANNELISATION
	prompt "Australian channelisation configuration"
	default WIFI_MORSEMICRO_AU_CHANNELISATION_REVMF
	help
		Australia's channelisation rules for 802.11ah changed in the 2024
		version of the 802.11 standard. Additionally, there is a proposal for
		2028 which includes better positioned 8 MHz channels.

	config WIFI_MORSEMICRO_AU_CHANNELISATION_2020
		bool "802.11-2020"
	config WIFI_MORSEMICRO_AU_CHANNELISATION_2024
		bool "802.11-2024"
	config WIFI_MORSEMICRO_AU_CHANNELISATION_REVMF
		bool "802.11-revmf"
endchoice

endmenu
```

## drivers/Kconfig
```kconfig
# Copyright 2024-2026 Morse Micro
# SPDX-License-Identifier: Apache-2.0
menu "Wi-Fi Drivers"
	rsource "wifi/Kconfig"
endmenu
```

## drivers/wifi/morsemicro/Kconfig.morsemicro
```kconfig
# Copyright 2024-2026 Morse Micro
# SPDX-License-Identifier: Apache-2.0

menuconfig WIFI_MORSEMICRO
	bool "Morse Micro HaLow Wi-Fi support"
	default y
	depends on DT_HAS_MORSEMICRO_MM6108_ENABLED \
		|| DT_HAS_MORSEMICRO_MM8108_ENABLED
	select DYNAMIC_THREAD
	select REBOOT
	select THREAD_CUSTOM_DATA
	select WIFI_USE_NATIVE_NETWORKING
	select NET_L2_WIFI_MGMT
	select NET_L2_ETHERNET
	select WIFI_NM
	select DYNAMIC_THREAD_ALLOC
	select GPIO_GET_CONFIG
	select HWINFO
	select CRC
	select FPU if CPU_CORTEX_M33 || CPU_CORTEX_M7
	select THREAD_ABORT_HOOK
	select ENTROPY_GENERATOR

if WIFI_MORSEMICRO

menu "Components"
	rsource "../../../components/morsemicro/regdb/Kconfig"
	rsource "../../../components/morsemicro/mmpktmem/Kconfig"
endmenu

choice WIFI_MORSEMICRO
	bool "Select BUS interface"
	default WIFI_MORSEMICRO_BUS_SPI

config WIFI_MORSEMICRO_BUS_SPI
	bool "SPI Bus interface"
	select SPI
endchoice

config WIFI_MORSEMICRO_POWERSAVE
	bool
	default y
	depends on (($(dt_compat_any_has_prop,$(DT_COMPAT_MORSEMICRO_MM8108),busy-gpios) \
	&& $(dt_compat_any_has_prop,$(DT_COMPAT_MORSEMICRO_MM8108),wakeup-gpios)) \
	|| ($(dt_compat_any_has_prop,$(DT_COMPAT_MORSEMICRO_MM6108),busy-gpios) \
	&& $(dt_compat_any_has_prop,$(DT_COMPAT_MORSEMICRO_MM6108),wakeup-gpios)))
	help
	  Enables power saving functionality on the Morse Micro chip.
	  Requires both the wakeup-gpios and busy-gpios are routed and defined.

config WIFI_MORSEMICRO_TEST
	bool "Morse Micro device test driver"
	help
	  Disable registration of network interface to allow testing.
	  To allow testing of the Morse Micro driver HAL layears, and verifying
	  the hardware configuration, this configuration will disable the
	  registration of the Morse Micro device as a Zephyr network interface.

config HEAP_MEM_POOL_ADD_SIZE_MORSEMICRO
	int
	default 65536

config NET_MGMT_EVENT_STACK_SIZE
	int
	default 2048

config NET_SOCKETS
	bool
	default y

config MORSEMICRO_COMPRESS_FIRMWARE
	bool "Compress the Morse Micro chip firmware"
	default y
	help
	  Compresses the firmware.
	  This results in a substantial reduction in flash space usage.
	  However this comes at the cost of additional time the Morse Micro
	  chip takes to boot since the firmware then needs to be decompressed again.

menuconfig ALPHA_FEATURES
	bool "Morse Micro Wi-Fi HaLow Alpha Features"
	default y

if ALPHA_FEATURES

config WIFI_MORSEMICRO_AP_MODE
	bool "Enables AP mode for the selected device"
	default n
	depends on ALPHA_FEATURES
	select POSIX_API
	help
	  Allows the device to use AP functionality.
	  Disabled by default as this takes up a substantial amount of flash.

choice WIFI_USAGE_MODE
	default WIFI_USAGE_MODE_STA_AP if WIFI_MORSEMICRO_AP_MODE
endchoice

config WIFI_MORSEMICRO_UNPATCHED_WORKAROUNDS
	bool "Add temporary workarounds for non patched zephyr instances"
	default n
	select WIFI_MORSEMICRO_SHELL if SHELL
	help
	  Add extra wifi mgmt calls for dealing with S1G specific behavior to avoid having to apply
	  patches. These patches are intended for upstreaming, and when they are pulled in to a
	  zephyr release, they will be deprecated and subsequently deprecated and then removed in
	  the follow up mm-iot-zephyr releases.

# Currently only needed for unpatched workarounds
config WIFI_MORSEMICRO_SHELL
	bool "Morse Micro driver shell commands"
	depends on SHELL
	depends on WIFI_MORSEMICRO_UNPATCHED_WORKAROUNDS
	default y if WIFI_MORSEMICRO_AP_MODE
	help
	  Adds a 'morsemicro' shell command for driver-specific functionality not
	  covered by the generic 'wifi' shell.

endif # ALPHA_FEATURES

endif

menuconfig ALPHA_FEATURES
	bool "Morse Micro Wi-Fi HaLow Alpha Features"
	default y

config WIFI_MORSEMICRO_AP_MODE
	bool "Enables AP mode for the selected device"
	default n
	depends on ALPHA_FEATURES
	select POSIX_API
	help
	  Allows the device to use AP functionality.
	  Disabled by default as this takes up a substantial amount of flash
```

## dts/bindings/wifi/morsemicro,mm6108-sd.yaml
```yaml
# Copyright 2026 Morse Micro
# SPDX-License-Identifier: Apache-2.0

description: Morse Micro Wi-Fi HaLow SoftMAC peripheral via an MM6108 on a SDIO bus

compatible: morsemicro,mm6108

on-bus: sd

include:
  - morsemicro,sm-sd.yaml
  - morsemicro,mm6108.yaml
```

## dts/bindings/wifi/morsemicro,mm6108-spi.yaml
```yaml
# Copyright 2024-2026 Morse Micro
# SPDX-License-Identifier: Apache-2.0

description: Morse Micro Wi-Fi HaLow SoftMAC peripheral via an MM6108 on a SPI bus

compatible: morsemicro,mm6108

on-bus: spi

include:
  - morsemicro,sm-spi.yaml
  - morsemicro,mm6108.yaml
```

## dts/bindings/wifi/morsemicro,mm6108.yaml
```yaml
# Copyright 2026 Morse Micro
# SPDX-License-Identifier: Apache-2.0

description: Morse Micro Wi-Fi HaLow MM6108 chip

properties:

  external-crystal-init:
    type: boolean
    required: false
    description: Flag for when the board/module has an external crystal requiring special initialzation
```

## dts/bindings/wifi/morsemicro,mm8108-sd.yaml
```yaml
# Copyright 2026 Morse Micro
# SPDX-License-Identifier: Apache-2.0

description: Morse Micro Wi-Fi HaLow SoftMAC peripheral via an MM8108 on a SDIO bus

compatible: morsemicro,mm8108

on-bus: sd

include:
  - morsemicro,sm-sd.yaml
```

## dts/bindings/wifi/morsemicro,mm8108-spi.yaml
```yaml
# Copyright 2024-2026 Morse Micro
# SPDX-License-Identifier: Apache-2.0

description: Morse Micro Wi-Fi HaLow Soft MAC peripheral via an MM8108 on a SPI bus

compatible: morsemicro,mm8108

on-bus: spi

include:
  - morsemicro,sm-spi.yaml
```
