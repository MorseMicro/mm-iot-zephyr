/*
 * Copyright 2026 Morse Micro
 * SPDX-License-Identifier: Apache-2.0
 */

&xiao_spi {
	status = "okay";

	cs-gpios = <&xiao_d 3 GPIO_ACTIVE_LOW>;

	morse_wifi_xiao_spi: morse@0 {
		status = "okay";
		compatible = "morsemicro,mm6108";
		bcf = "bcf_fgh100mhaamd.bin";
		spi-max-frequency = <DT_FREQ_M(50)>;
		reg = <0>;

		resetn-gpios =  <&xiao_d 0 GPIO_ACTIVE_LOW>;
		spi-irq-gpios = <&xiao_d 2 GPIO_ACTIVE_LOW>;
	};
};
