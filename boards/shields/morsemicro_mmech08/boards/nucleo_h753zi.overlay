/*
 * Copyright 2024 Morse Micro
 * SPDX-License-Identifier: Apache-2.0
 */

&spi1_miso_pa6 {
	drive-push-pull;
	bias-disable;
	/delete-property/ bias-pull-down;
	slew-rate = "very-high-speed";
};

&spi1_sck_pa5 {
	drive-push-pull;
	bias-disable;
	/delete-property/ bias-pull-down;
	slew-rate = "very-high-speed";
};

&spi1_mosi_pb5 {
	drive-push-pull;
	bias-disable;
	/delete-property/ bias-pull-down;
	slew-rate = "very-high-speed";
};

&mac {
	status = "disabled";
};