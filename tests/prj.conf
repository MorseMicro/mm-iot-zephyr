## CMakeLists.txt
```
# Copyright 2026 Morse Micro
# SPDX-License-Identifier: Apache-2.0

cmake_minimum_required(VERSION 3.20.0)
find_package(Zephyr REQUIRED HINTS $ENV{ZEPHYR_BASE})
project(halow_pytest)

target_sources(app PRIVATE src/main.c)
```

## prj.conf
```kconfig
# Copyright 2026 Morse Micro
# SPDX-License-Identifier: Apache-2.0

CONFIG_LOG=y
CONFIG_SHELL=y
CONFIG_SHELL_VT100_COMMANDS=n
CONFIG_SHELL_VT100_COLORS=n

CONFIG_NETWORKING=y
CONFIG_NET_IPV4=y
CONFIG_NET_IPV6=n
CONFIG_NET_DHCPV4=y
CONFIG_NET_SHELL=y

CONFIG_WIFI=y
CONFIG_NET_L2_WIFI_SHELL=y

CONFIG_NET_UDP=y
CONFIG_NET_TCP=y
CONFIG_DNS_RESOLVER=y
CONFIG_DNS_SERVER_IP_ADDRESSES=y
CONFIG_DNS_SERVER1="8.8.8.8"
CONFIG_DNS_SERVER2="1.1.1.1"

CONFIG_MAIN_STACK_SIZE=4096
CONFIG_HEAP_MEM_POOL_SIZE=16384
```

## boards/xiao_esp32c3.conf
```kconfig
#
# Copyright 2026 Morse Micro
#
# SPDX-License-Identifier: Apache-2.0
#

# The C3 has less internal SRAM than the S3/C6, and none of the pytest
# suites in tests/pytest exercise zperf, so drop it here to fit in dram0.
CONFIG_NET_ZPERF=n
```

## src/main.c
```c
/*
 * Copyright 2026 Morse Micro
 *
 * SPDX-License-Identifier: Apache-2.0
 */

int main(void)
{
	return 0;
}
```
